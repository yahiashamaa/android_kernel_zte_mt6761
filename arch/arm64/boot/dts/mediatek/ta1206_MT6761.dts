/dts-v1/;

/ {
	model = "MT6761";
	compatible = "mediatek,MT6761";
	interrupt-parent = <0x1>;
	#address-cells = <0x2>;
	#size-cells = <0x2>;

	chosen {
		bootargs = "console=tty0 console=ttyS0,921600n1 vmalloc=496M slub_max_order=0 slub_debug=OFZPU page_owner=on androidboot.hardware=mt6761 maxcpus=8 firmware_class.path=/vendor/firmware loop.max_part=7";
		linux,phandle = <0x45>;
		phandle = <0x45>;
	};

	cpus {
		#address-cells = <0x1>;
		#size-cells = <0x0>;

		cpu@000 {
			device_type = "cpu";
			compatible = "arm,cortex-a53";
			reg = <0x0>;
			enable-method = "psci";
			clock-frequency = <0x8b799100>;
			cpu-idle-states = <0x2 0x3 0x4 0x5 0x6 0x7 0x8>;
			linux,phandle = <0x9>;
			phandle = <0x9>;
		};

		cpu@001 {
			device_type = "cpu";
			compatible = "arm,cortex-a53";
			reg = <0x1>;
			enable-method = "psci";
			clock-frequency = <0x8b799100>;
			cpu-idle-states = <0x2 0x3 0x4 0x5 0x6 0x7 0x8>;
			linux,phandle = <0xa>;
			phandle = <0xa>;
		};

		cpu@002 {
			device_type = "cpu";
			compatible = "arm,cortex-a53";
			reg = <0x2>;
			enable-method = "psci";
			clock-frequency = <0x8b799100>;
			cpu-idle-states = <0x2 0x3 0x4 0x5 0x6 0x7 0x8>;
			linux,phandle = <0xb>;
			phandle = <0xb>;
		};

		cpu@003 {
			device_type = "cpu";
			compatible = "arm,cortex-a53";
			reg = <0x3>;
			enable-method = "psci";
			clock-frequency = <0x8b799100>;
			cpu-idle-states = <0x2 0x3 0x4 0x5 0x6 0x7 0x8>;
			linux,phandle = <0xc>;
			phandle = <0xc>;
		};

		cpu-map {

			cluster0 {

				core0 {
					cpu = <0x9>;
				};

				core1 {
					cpu = <0xa>;
				};

				core2 {
					cpu = <0xb>;
				};

				core3 {
					cpu = <0xc>;
				};
			};
		};

		idle-states {
			entry-method = "arm,psci";

			standby {
				compatible = "arm,idle-state";
				arm,psci-suspend-param = <0x1>;
				entry-latency-us = <0x258>;
				exit-latency-us = <0x258>;
				min-residency-us = <0x4b0>;
				linux,phandle = <0x2>;
				phandle = <0x2>;
			};

			mcdi-cpu {
				compatible = "arm,idle-state";
				arm,psci-suspend-param = <0x10001>;
				entry-latency-us = <0x258>;
				exit-latency-us = <0x258>;
				min-residency-us = <0x4b0>;
				linux,phandle = <0x3>;
				phandle = <0x3>;
			};

			mcdi-cluster {
				compatible = "arm,idle-state";
				arm,psci-suspend-param = <0x1010001>;
				entry-latency-us = <0x258>;
				exit-latency-us = <0x258>;
				min-residency-us = <0x4b0>;
				linux,phandle = <0x4>;
				phandle = <0x4>;
			};

			sodi {
				compatible = "arm,idle-state";
				arm,psci-suspend-param = <0x1010002>;
				entry-latency-us = <0x320>;
				exit-latency-us = <0x3e8>;
				min-residency-us = <0x7d0>;
				linux,phandle = <0x5>;
				phandle = <0x5>;
			};

			sodi3 {
				compatible = "arm,idle-state";
				arm,psci-suspend-param = <0x1010003>;
				entry-latency-us = <0x320>;
				exit-latency-us = <0x3e8>;
				min-residency-us = <0x7d0>;
				linux,phandle = <0x6>;
				phandle = <0x6>;
			};

			dpidle {
				compatible = "arm,idle-state";
				arm,psci-suspend-param = <0x1010004>;
				entry-latency-us = <0x320>;
				exit-latency-us = <0x3e8>;
				min-residency-us = <0x7d0>;
				linux,phandle = <0x7>;
				phandle = <0x7>;
			};

			suspend {
				compatible = "arm,idle-state";
				arm,psci-suspend-param = <0x1010005>;
				entry-latency-us = <0x320>;
				exit-latency-us = <0x3e8>;
				min-residency-us = <0x7d0>;
				linux,phandle = <0x8>;
				phandle = <0x8>;
			};
		};
	};

	psci {
		compatible = "arm,psci-1.0";
		method = "smc";
	};

	pmu {
		compatible = "arm,cortex-a7-pmu";
		interrupt-parent = <0xd>;
		interrupts = <0x1 0x7 0x8>;
	};

	l2c_parity {
		compatible = "mediatek,l2c_parity-v1";
		interrupts = <0x0 0x0 0x4>;
	};

	memory {
		device_type = "memory";
		reg = <0x0 0x40000000 0x0 0x20000000>;
	};

	reserved-memory {
		#address-cells = <0x2>;
		#size-cells = <0x2>;
		ranges;

		ram_console-reserved-memory@47c80000 {
			compatible = "mediatek,ram_console";
			reg = <0x0 0x47c80000 0x0 0x10000>;
		};

		pstore-reserved-memory@47c90000 {
			compatible = "mediatek,pstore";
			reg = <0x0 0x47c90000 0x0 0xe0000>;
		};

		minirdump-reserved-memory@47d70000 {
			compatible = "mediatek,minirdump";
			reg = <0x0 0x47d70000 0x0 0x10000>;
		};

		reserve-memory-sspm_share {
			compatible = "mediatek,reserve-memory-sspm_share";
			no-map;
			status = "okay";
			size = <0x0 0x510000>;
			alignment = <0x0 0x10000>;
			alloc-ranges = <0x0 0x40000000 0x0 0x60000000>;
		};

		reserve-memory-scp_share {
			compatible = "mediatek,reserve-memory-scp_share";
			no-map;
			size = <0x0 0x300000>;
			alignment = <0x0 0x1000000>;
			alloc-ranges = <0x0 0x40000000 0x0 0x50000000>;
		};

		consys-reserve-memory {
			compatible = "mediatek,consys-reserve-memory";
			no-map;
			size = <0x0 0x400000>;
			alignment = <0x0 0x1000000>;
			alloc-ranges = <0x0 0x40000000 0x0 0x80000000>;
		};

		wifi-reserve-memory {
			compatible = "mediatek,wifi-reserve-memory";
			no-map;
			size = <0x0 0x300000>;
			alignment = <0x0 0x1000000>;
			alloc-ranges = <0x0 0x40000000 0x0 0x80000000>;
		};
	};

	utos {
		compatible = "microtrust,utos";
		interrupts = <0x0 0xbc 0x1 0x0 0xbd 0x1>;
	};

	utos_tester {
		compatible = "microtrust,tester-v1";
	};

	cpu_dbgapb@0d410000 {
		compatible = "mediatek,hw_dbg";
		num = <0x8>;
		reg = <0x0 0xd410000 0x0 0x1000 0x0 0xd510000 0x0 0x1000 0x0 0xd610000 0x0 0x1000 0x0 0xd710000 0x0 0x1000 0x0 0xd810000 0x0 0x1000 0x0 0xd910000 0x0 0x1000 0x0 0xda10000 0x0 0x1000 0x0 0xdb10000 0x0 0x1000>;
		linux,phandle = <0x46>;
		phandle = <0x46>;
	};

	atf_logger {
		compatible = "mediatek,atf_logger";
		interrupts = <0x0 0x4e 0x1>;
	};

	amms_control {
		compatible = "mediatek,amms";
		interrupts = <0x0 0x43 0x1>;
	};

	interrupt-controller@0c000000 {
		compatible = "arm,gic-v3";
		#interrupt-cells = <0x3>;
		#address-cells = <0x2>;
		#size-cells = <0x2>;
		#redistributor-regions = <0x1>;
		interrupt-parent = <0xd>;
		interrupt-controller;
		reg = <0x0 0xc000000 0x0 0x40000 0x0 0xc080000 0x0 0x200000 0x0 0x10200a80 0x0 0x50>;
		interrupts = <0x1 0x9 0x4>;
		linux,phandle = <0xd>;
		phandle = <0xd>;
	};

	intpol-controller@10200a80 {
		compatible = "mediatek,mt6577-sysirq";
		interrupt-controller;
		#interrupt-cells = <0x3>;
		interrupt-parent = <0xd>;
		reg = <0x0 0x10200a80 0x0 0x50>;
		linux,phandle = <0x1>;
		phandle = <0x1>;
	};

	infracfg_ao@10001000 {
		compatible = "mediatek,infracfg_ao", "syscon";
		reg = <0x0 0x10001000 0x0 0x1000>;
		interrupts = <0x0 0x5b 0x1>;
		#clock-cells = <0x1>;
		linux,phandle = <0x20>;
		phandle = <0x20>;
	};

	mcdi@0010fc00 {
		compatible = "mediatek,mt6761-mcdi";
		reg = <0x0 0x10fc00 0x0 0x800>;
	};

	scpsys@10001000 {
		compatible = "mediatek,scpsys", "syscon";
		reg = <0x0 0x10001000 0x0 0x1000 0x0 0x10006000 0x0 0x1000 0x0 0x14002000 0x0 0x1000 0x0 0x1020e000 0x0 0x1000 0x0 0x18004000 0x0 0x1000>;
		#clock-cells = <0x1>;
		linux,phandle = <0x21>;
		phandle = <0x21>;
	};

	topckgen@10000000 {
		compatible = "mediatek,topckgen", "syscon";
		reg = <0x0 0x10000000 0x0 0x1000>;
		#clock-cells = <0x1>;
		linux,phandle = <0x19>;
		phandle = <0x19>;
	};

	io_cfg_lt@10002000 {
		compatible = "mediatek,io_cfg_lt";
		reg = <0x0 0x10002000 0x0 0x200>;
	};

	syscfg_pctl_1@10002000 {
		compatible = "mediatek,mt6761-pctl-1-syscfg", "syscon";
		reg = <0x0 0x10002000 0x0 0x1000>;
		linux,phandle = <0x12>;
		phandle = <0x12>;
	};

	io_cfg_lm@10002200 {
		compatible = "mediatek,io_cfg_lm";
		reg = <0x0 0x10002200 0x0 0x200>;
	};

	syscfg_pctl_2@10002200 {
		compatible = "mediatek,mt6761-pctl-2-syscfg", "syscon";
		reg = <0x0 0x10002200 0x0 0x1000>;
		linux,phandle = <0x13>;
		phandle = <0x13>;
	};

	io_cfg_lb@10002400 {
		compatible = "mediatek,io_cfg_lb";
		reg = <0x0 0x10002400 0x0 0x200>;
	};

	syscfg_pctl_3@10002400 {
		compatible = "mediatek,mt6761-pctl-3-syscfg", "syscon";
		reg = <0x0 0x10002400 0x0 0x1000>;
		linux,phandle = <0x14>;
		phandle = <0x14>;
	};

	io_cfg_bl@10002600 {
		compatible = "mediatek,io_cfg_bl";
		reg = <0x0 0x10002600 0x0 0x200>;
	};

	syscfg_pctl_4@10002600 {
		compatible = "mediatek,mt6761-pctl-4-syscfg", "syscon";
		reg = <0x0 0x10002600 0x0 0x1000>;
		linux,phandle = <0x15>;
		phandle = <0x15>;
	};

	io_cfg_rr@10002800 {
		compatible = "mediatek,io_cfg_rr";
		reg = <0x0 0x10002800 0x0 0x200>;
	};

	syscfg_pctl_5@10002800 {
		compatible = "mediatek,mt6761-pctl-5-syscfg", "syscon";
		reg = <0x0 0x10002800 0x0 0x1000>;
		linux,phandle = <0x16>;
		phandle = <0x16>;
	};

	io_cfg_rb@10002a00 {
		compatible = "mediatek,io_cfg_rb";
		reg = <0x0 0x10002a00 0x0 0x200>;
	};

	syscfg_pctl_6@10002a00 {
		compatible = "mediatek,mt6761-pctl-6-syscfg", "syscon";
		reg = <0x0 0x10002a00 0x0 0x1000>;
		linux,phandle = <0x17>;
		phandle = <0x17>;
	};

	io_cfg_rt@10002c00 {
		compatible = "mediatek,io_cfg_rt";
		reg = <0x0 0x10002c00 0x0 0x200>;
	};

	syscfg_pctl_7@10002c00 {
		compatible = "mediatek,mt6761-pctl-7-syscfg", "syscon";
		reg = <0x0 0x10002c00 0x0 0x1000>;
		linux,phandle = <0x18>;
		phandle = <0x18>;
	};

	pericfg@10003000 {
		compatible = "mediatek,pericfg", "syscon";
		reg = <0x0 0x10003000 0x0 0x1000>;
		#clock-cells = <0x1>;
		linux,phandle = <0x47>;
		phandle = <0x47>;
	};

	efuse_dbg@10004000 {
		compatible = "mediatek,efuse_dbg";
		reg = <0x0 0x10004000 0x0 0x1000>;
	};

	smart_pa {
		linux,phandle = <0x48>;
		phandle = <0x48>;
	};

	tcpc_pd {
		linux,phandle = <0x49>;
		phandle = <0x49>;
	};

	md1_sim1_hot_plug_eint {
		linux,phandle = <0x4a>;
		phandle = <0x4a>;
	};

	md1_sim2_hot_plug_eint {
		linux,phandle = <0x4b>;
		phandle = <0x4b>;
	};

	gpio {
		compatible = "mediatek,gpio_usage_mapping";
		linux,phandle = <0x4c>;
		phandle = <0x4c>;
	};

	gpio@10005000 {
		compatible = "mediatek,gpio";
		reg = <0x0 0x10005000 0x0 0x1000>;
		linux,phandle = <0x4d>;
		phandle = <0x4d>;
	};

	syscfg_pctl_0@10005000 {
		compatible = "mediatek,mt6761-pctl-0-syscfg", "syscon";
		reg = <0x0 0x10005000 0x0 0x1000>;
		linux,phandle = <0x11>;
		phandle = <0x11>;
	};

	sleep@10006000 {
		compatible = "mediatek,sleep";
		reg = <0x0 0x10006000 0x0 0x1000>;
		interrupts = <0x0 0x7d 0x8>;
		wakeup-source = <0xe 0x0 0x4 0xf 0x1 0x20 0x10 0x3 0x2000000>;
	};

	pinctrl@1000b000 {
		compatible = "mediatek,mt6761-pinctrl";
		reg = <0x0 0x1000b000 0x0 0x1000>;
		mediatek,pctl-regmap = <0x11 0x12 0x13 0x14 0x15 0x16 0x17 0x18>;
		pins-are-numbered;
		gpio-controller;
		#gpio-cells = <0x2>;
		interrupt-controller;
		#interrupt-cells = <0x4>;
		interrupts = <0x0 0x73 0x4>;
		linux,phandle = <0x1c>;
		phandle = <0x1c>;

		msdc0@default {
			linux,phandle = <0x2e>;
			phandle = <0x2e>;

			pins_cmd {
				drive-strength = [03];
			};

			pins_dat {
				drive-strength = [03];
			};

			pins_clk {
				drive-strength = [03];
			};

			pins_rst {
				drive-strength = [03];
			};

			pins_ds {
				drive-strength = [03];
			};
		};

		msdc0@hs400 {
			linux,phandle = <0x2f>;
			phandle = <0x2f>;

			pins_cmd {
				drive-strength = [03];
			};

			pins_dat {
				drive-strength = [04];
			};

			pins_clk {
				drive-strength = [04];
			};

			pins_rst {
				drive-strength = [03];
			};

			pins_ds {
				drive-strength = [04];
			};
		};

		msdc0@hs200 {
			linux,phandle = <0x30>;
			phandle = <0x30>;

			pins_cmd {
				drive-strength = [03];
			};

			pins_dat {
				drive-strength = [04];
			};

			pins_clk {
				drive-strength = [04];
			};

			pins_rst {
				drive-strength = [03];
			};

			pins_ds {
				drive-strength = [04];
			};
		};

		msdc0@register_default {
			cmd_edge = [00];
			rdata_edge = [00];
			wdata_edge = [00];
			linux,phandle = <0x31>;
			phandle = <0x31>;
		};

		msdc1@default {
			linux,phandle = <0x33>;
			phandle = <0x33>;

			pins_cmd {
				drive-strength = [03];
			};

			pins_dat {
				drive-strength = [03];
			};

			pins_clk {
				drive-strength = [03];
			};
		};

		msdc1@sdr104 {
			linux,phandle = <0x34>;
			phandle = <0x34>;

			pins_cmd {
				drive-strength = [03];
			};

			pins_dat {
				drive-strength = [03];
			};

			pins_clk {
				drive-strength = [03];
			};
		};

		msdc1@sdr50 {
			linux,phandle = <0x35>;
			phandle = <0x35>;

			pins_cmd {
				drive-strength = [03];
			};

			pins_dat {
				drive-strength = [03];
			};

			pins_clk {
				drive-strength = [03];
			};
		};

		msdc1@ddr50 {
			linux,phandle = <0x36>;
			phandle = <0x36>;

			pins_cmd {
				drive-strength = [03];
			};

			pins_dat {
				drive-strength = [03];
			};

			pins_clk {
				drive-strength = [03];
			};
		};

		msdc1@register_default {
			cmd_edge = [00];
			rdata_edge = [00];
			wdata_edge = [00];
			linux,phandle = <0x37>;
			phandle = <0x37>;
		};

		msdc3@default {
			linux,phandle = <0x4e>;
			phandle = <0x4e>;

			pins_cmd {
				drive-strength = [04];
			};

			pins_dat {
				drive-strength = [04];
			};

			pins_clk {
				drive-strength = [04];
			};
		};

		msdc3@register_default {
			cmd_edge = [01];
			rdata_edge = [01];
			wdata_edge = [01];
			linux,phandle = <0x4f>;
			phandle = <0x4f>;
		};
	};

	toprgu@10007000 {
		compatible = "mediatek,toprgu";
		reg = <0x0 0x10007000 0x0 0x1000>;
		interrupts = <0x0 0x53 0x0>;
	};

	chipid@08000000 {
		compatible = "mediatek,chipid";
		reg = <0x0 0x8000000 0x0 0x4 0x0 0x8000004 0x0 0x4 0x0 0x8000008 0x0 0x4 0x0 0x800000c 0x0 0x4>;
	};

	mobicore {
		compatible = "trustonic,mobicore";
		interrupts = <0x0 0xc2 0x1>;
	};

	tkcore {
		compatible = "trustkernel,tkcore";
		interrupts = <0x0 0xc4 0x1>;
	};

	timer {
		compatible = "arm,armv8-timer";
		interrupt-parent = <0xd>;
		interrupts = <0x1 0xd 0x8 0x1 0xe 0x8 0x1 0xb 0x8 0x1 0xa 0x8>;
		clock-frequency = <0xc65d40>;
	};

	clocks {

		clk26m {
			compatible = "fixed-clock";
			#clock-cells = <0x0>;
			clock-frequency = <0x18cba80>;
			linux,phandle = <0x1b>;
			phandle = <0x1b>;
		};

		clk32k {
			compatible = "fixed-clock";
			#clock-cells = <0x0>;
			clock-frequency = <0x7d00>;
			linux,phandle = <0x1a>;
			phandle = <0x1a>;
		};
	};

	timer@10008000 {
		compatible = "mediatek,apxgpt";
		reg = <0x0 0x10008000 0x0 0x1000>;
		interrupts = <0x0 0x72 0x8>;
		clocks = <0x19 0x87 0x1a>;
		clock-names = "clk13m", "clk32k";
		linux,phandle = <0x50>;
		phandle = <0x50>;
	};

	hacc@1000a000 {
		compatible = "mediatek,hacc";
		reg = <0x0 0x1000a000 0x0 0x1000>;
		interrupts = <0x0 0x85 0x8>;
	};

	apirq@1000b000 {
		compatible = "mediatek,apirq";
		reg = <0x0 0x1000b000 0x0 0x1000>;
		interrupts = <0x0 0x73 0x4>;
	};

	apmixed@1000c000 {
		compatible = "mediatek,apmixed", "syscon";
		reg = <0x0 0x1000c000 0x0 0x1000>;
		#clock-cells = <0x1>;
		linux,phandle = <0x3b>;
		phandle = <0x3b>;
	};

	fhctl@1000ce00 {
		compatible = "mediatek,fhctl";
		reg = <0x0 0x1000ce00 0x0 0x200>;
	};

	pwrap@1000d000 {
		compatible = "mediatek,pwrap";
		reg = <0x0 0x1000d000 0x0 0x1000>;
		interrupts = <0x0 0x7b 0x4>;
	};

	mt-pmic {
		compatible = "mediatek,mt_pmic";
		interrupt-controller;
		linux,phandle = <0x51>;
		phandle = <0x51>;

		mt635x-auxadc {
			compatible = "mediatek,mt635x-auxadc";
			#io-channel-cells = <0x1>;
			linux,phandle = <0x52>;
			phandle = <0x52>;

			batadc {
				channel = <0x0>;
				resistance-ratio = <0x3 0x1>;
				avg-num = <0x80>;
			};

			isense {
				channel = <0x1>;
				resistance-ratio = <0x3 0x1>;
				avg-num = <0x80>;
			};

			vcdt {
				channel = <0x2>;
			};

			bat_temp {
				channel = <0x3>;
				resistance-ratio = <0x1 0x1>;
			};

			chip_temp {
				channel = <0x5>;
			};

			vcore_temp {
				channel = <0x6>;
			};

			vproc_temp {
				channel = <0x7>;
			};

			accdet {
				channel = <0x9>;
			};

			tsx_temp {
				channel = <0xb>;
				avg-num = <0x80>;
			};

			hpofs_cal {
				channel = <0xc>;
				avg-num = <0x100>;
			};

			dcxo_temp {
				channel = <0xd>;
				avg-num = <0x10>;
			};

			vbif {
				channel = <0xe>;
				resistance-ratio = <0x1 0x1>;
			};
		};

		buck_regulators {

			buck_vs1 {
				regulator-name = "vs1";
				regulator-min-microvolt = <0x124f80>;
				regulator-max-microvolt = <0x2191c0>;
				regulator-ramp-delay = <0x30d4>;
				regulator-enable-ramp-delay = <0xdc>;
				linux,phandle = <0x53>;
				phandle = <0x53>;
			};

			buck_vmodem {
				regulator-name = "vmodem";
				regulator-min-microvolt = <0x7a120>;
				regulator-max-microvolt = <0x123716>;
				regulator-ramp-delay = <0x186a>;
				regulator-enable-ramp-delay = <0xdc>;
				linux,phandle = <0x54>;
				phandle = <0x54>;
			};

			buck_vcore {
				regulator-name = "vcore";
				regulator-min-microvolt = <0x7ea5e>;
				regulator-max-microvolt = <0x1406f4>;
				regulator-ramp-delay = <0x186a>;
				regulator-enable-ramp-delay = <0xdc>;
				linux,phandle = <0x55>;
				phandle = <0x55>;
			};

			buck_vproc {
				regulator-name = "vproc";
				regulator-min-microvolt = <0x7ea5e>;
				regulator-max-microvolt = <0x1406f4>;
				regulator-ramp-delay = <0x186a>;
				regulator-enable-ramp-delay = <0xdc>;
				linux,phandle = <0x56>;
				phandle = <0x56>;
			};

			buck_vpa {
				regulator-name = "vpa";
				regulator-min-microvolt = <0x7a120>;
				regulator-max-microvolt = <0x37b1d0>;
				regulator-ramp-delay = <0xc350>;
				regulator-enable-ramp-delay = <0xdc>;
				linux,phandle = <0x57>;
				phandle = <0x57>;
			};
		};

		ldo_regulators {

			ldo_vfe28 {
				compatible = "regulator-fixed";
				regulator-name = "vfe28";
				regulator-min-microvolt = <0x2ab980>;
				regulator-max-microvolt = <0x2ab980>;
				regulator-enable-ramp-delay = <0x108>;
				linux,phandle = <0x58>;
				phandle = <0x58>;
			};

			ldo_vxo22 {
				regulator-name = "vxo22";
				regulator-min-microvolt = <0x2191c0>;
				regulator-max-microvolt = <0x249f00>;
				regulator-enable-ramp-delay = <0x6e>;
				linux,phandle = <0x59>;
				phandle = <0x59>;
			};

			ldo_vrf18 {
				compatible = "regulator-fixed";
				regulator-name = "vrf18";
				regulator-min-microvolt = <0x1b7740>;
				regulator-max-microvolt = <0x1b7740>;
				regulator-enable-ramp-delay = <0x6e>;
				linux,phandle = <0x5a>;
				phandle = <0x5a>;
			};

			ldo_vrf12 {
				compatible = "regulator-fixed";
				regulator-name = "vrf12";
				regulator-min-microvolt = <0x124f80>;
				regulator-max-microvolt = <0x124f80>;
				regulator-enable-ramp-delay = <0x6e>;
				linux,phandle = <0x5b>;
				phandle = <0x5b>;
			};

			ldo_vefuse {
				regulator-name = "vefuse";
				regulator-min-microvolt = <0x124f80>;
				regulator-max-microvolt = <0x325aa0>;
				regulator-enable-ramp-delay = <0x108>;
				linux,phandle = <0x5c>;
				phandle = <0x5c>;
			};

			ldo_vcn33_bt {
				regulator-name = "vcn33_bt";
				regulator-min-microvolt = <0x325aa0>;
				regulator-max-microvolt = <0x3567e0>;
				regulator-enable-ramp-delay = <0x108>;
				linux,phandle = <0x5d>;
				phandle = <0x5d>;
			};

			ldo_vcn33_wifi {
				regulator-name = "vcn33_wifi";
				regulator-min-microvolt = <0x325aa0>;
				regulator-max-microvolt = <0x3567e0>;
				regulator-enable-ramp-delay = <0x108>;
				linux,phandle = <0x5e>;
				phandle = <0x5e>;
			};

			ldo_vcn28 {
				compatible = "regulator-fixed";
				regulator-name = "vcn28";
				regulator-min-microvolt = <0x2ab980>;
				regulator-max-microvolt = <0x2ab980>;
				regulator-enable-ramp-delay = <0x108>;
				linux,phandle = <0x5f>;
				phandle = <0x5f>;
			};

			ldo_vcn18 {
				compatible = "regulator-fixed";
				regulator-name = "vcn18";
				regulator-min-microvolt = <0x1b7740>;
				regulator-max-microvolt = <0x1b7740>;
				regulator-enable-ramp-delay = <0x108>;
				linux,phandle = <0x60>;
				phandle = <0x60>;
			};

			ldo_vcama {
				regulator-name = "vcama";
				regulator-min-microvolt = <0x2625a0>;
				regulator-max-microvolt = <0x2ab980>;
				regulator-enable-ramp-delay = <0x108>;
				linux,phandle = <0x61>;
				phandle = <0x61>;
			};

			ldo_vcamd {
				regulator-name = "vcamd";
				regulator-min-microvolt = <0xf4240>;
				regulator-max-microvolt = <0x1b7740>;
				regulator-enable-ramp-delay = <0x108>;
				linux,phandle = <0x62>;
				phandle = <0x62>;
			};

			ldo_vcamio {
				compatible = "regulator-fixed";
				regulator-name = "vcamio";
				regulator-min-microvolt = <0x1b7740>;
				regulator-max-microvolt = <0x1b7740>;
				regulator-enable-ramp-delay = <0x108>;
				linux,phandle = <0x63>;
				phandle = <0x63>;
			};

			ldo_vldo28 {
				regulator-name = "vldo28";
				regulator-min-microvolt = <0x2ab980>;
				regulator-max-microvolt = <0x2dc6c0>;
				regulator-enable-ramp-delay = <0x108>;
				linux,phandle = <0x64>;
				phandle = <0x64>;
			};

			ldo_vsram_others {
				regulator-name = "vsram_others";
				regulator-min-microvolt = <0x7ea5e>;
				regulator-max-microvolt = <0x1406f4>;
				regulator-ramp-delay = <0x186a>;
				regulator-enable-ramp-delay = <0x6e>;
				linux,phandle = <0x65>;
				phandle = <0x65>;
			};

			ldo_vsram_proc {
				regulator-name = "vsram_proc";
				regulator-min-microvolt = <0x7ea5e>;
				regulator-max-microvolt = <0x1406f4>;
				regulator-ramp-delay = <0x186a>;
				regulator-enable-ramp-delay = <0x6e>;
				linux,phandle = <0x66>;
				phandle = <0x66>;
			};

			ldo_vaux18 {
				compatible = "regulator-fixed";
				regulator-name = "vaux18";
				regulator-min-microvolt = <0x1b7740>;
				regulator-max-microvolt = <0x1b7740>;
				regulator-enable-ramp-delay = <0x108>;
				linux,phandle = <0x67>;
				phandle = <0x67>;
			};

			ldo_vaud28 {
				compatible = "regulator-fixed";
				regulator-name = "vaud28";
				regulator-min-microvolt = <0x2ab980>;
				regulator-max-microvolt = <0x2ab980>;
				regulator-enable-ramp-delay = <0x108>;
				linux,phandle = <0x68>;
				phandle = <0x68>;
			};

			ldo_vio28 {
				compatible = "regulator-fixed";
				regulator-name = "vio28";
				regulator-min-microvolt = <0x2ab980>;
				regulator-max-microvolt = <0x2ab980>;
				regulator-enable-ramp-delay = <0x108>;
				linux,phandle = <0x69>;
				phandle = <0x69>;
			};

			ldo_vio18 {
				compatible = "regulator-fixed";
				regulator-name = "vio18";
				regulator-min-microvolt = <0x1b7740>;
				regulator-max-microvolt = <0x1b7740>;
				regulator-enable-ramp-delay = <0x108>;
				linux,phandle = <0x6a>;
				phandle = <0x6a>;
			};

			ldo_vdram {
				regulator-name = "vdram";
				regulator-min-microvolt = <0x10c8e0>;
				regulator-max-microvolt = <0x124f80>;
				regulator-enable-ramp-delay = <0xce4>;
				linux,phandle = <0x6b>;
				phandle = <0x6b>;
			};

			ldo_vmc {
				regulator-name = "vmc";
				regulator-min-microvolt = <0x1b7740>;
				regulator-max-microvolt = <0x325aa0>;
				regulator-enable-ramp-delay = <0x2c>;
				linux,phandle = <0x39>;
				phandle = <0x39>;
			};

			ldo_vmch {
				regulator-name = "vmch";
				regulator-min-microvolt = <0x2c4020>;
				regulator-max-microvolt = <0x325aa0>;
				regulator-enable-ramp-delay = <0x2c>;
				linux,phandle = <0x38>;
				phandle = <0x38>;
			};

			ldo_vemc {
				regulator-name = "vemc";
				regulator-min-microvolt = <0x2c4020>;
				regulator-max-microvolt = <0x325aa0>;
				regulator-enable-ramp-delay = <0x2c>;
				linux,phandle = <0x32>;
				phandle = <0x32>;
			};

			ldo_vsim1 {
				regulator-name = "vsim1";
				regulator-min-microvolt = <0x19f0a0>;
				regulator-max-microvolt = <0x2f4d60>;
				regulator-enable-ramp-delay = <0x108>;
				linux,phandle = <0x6c>;
				phandle = <0x6c>;
			};

			ldo_vsim2 {
				regulator-name = "vsim2";
				regulator-min-microvolt = <0x19f0a0>;
				regulator-max-microvolt = <0x2f4d60>;
				regulator-enable-ramp-delay = <0x108>;
				linux,phandle = <0x6d>;
				phandle = <0x6d>;
			};

			ldo_vibr {
				regulator-name = "vibr";
				regulator-min-microvolt = <0x124f80>;
				regulator-max-microvolt = <0x325aa0>;
				regulator-enable-ramp-delay = <0x2c>;
				linux,phandle = <0x6e>;
				phandle = <0x6e>;
			};

			ldo_vusb33 {
				regulator-name = "vusb33";
				regulator-min-microvolt = <0x2dc6c0>;
				regulator-max-microvolt = <0x2f4d60>;
				regulator-enable-ramp-delay = <0x108>;
				linux,phandle = <0x6f>;
				phandle = <0x6f>;
			};
		};
	};

	scp@10500000 {
		compatible = "mediatek,scp";
		status = "okay";
		reg = <0x0 0x10500000 0x0 0x40000 0x0 0x105c0000 0x0 0x3000 0x0 0x105c4000 0x0 0x1000 0x0 0x105d4000 0x0 0x6000>;
		interrupts = <0x0 0x88 0x4>;
		core_1 = "enable";
		scp_sramSize = <0x40000>;
	};

	scp_dvfs {
		compatible = "mediatek,scp_dvfs";
		clocks = <0x19 0x6c 0x1b 0x19 0x10 0x19 0x1d 0x19 0x4 0x19 0x1a 0x19 0x8 0x19 0x1c>;
		clock-names = "clk_mux", "clk_pll_0", "clk_pll_1", "clk_pll_2", "clk_pll_3", "clk_pll_4", "clk_pll_5", "clk_pll_6";
	};

	sleep_reg_md@1000f000 {
		compatible = "mediatek,sleep_reg_md";
		reg = <0x0 0x1000f000 0x0 0x1000>;
	};

	kp@10010000 {
		compatible = "mediatek,kp";
		reg = <0x0 0x10010000 0x0 0x1000>;
		interrupts = <0x0 0x7c 0x2>;
		linux,phandle = <0xe>;
		phandle = <0xe>;
	};

	mrdump_ext_rst {
		compatible = "mediatek, mrdump_ext_rst-eint";
		source = "EINT";
		mode = "IRQ";
		status = "okay";
		linux,phandle = <0x70>;
		phandle = <0x70>;
	};

	key_google {
		compatible = "mediatek, key_google_key-eint";
		interrupt-parent = <0x1c>;
		interrupts = <0x3 0x8 0x3 0x0>;
		deb-gpios = <0x1c 0x3 0x0>;
		debounce = <0xfa00>;
		status = "okay";
		linux,phandle = <0x71>;
		phandle = <0x71>;
	};

	touch {
		compatible = "mediatek,touch";
		linux,phandle = <0x72>;
		phandle = <0x72>;
	};

	lcm_gpio {
		compatible = "mediatek,lcm_gpio";
		linux,phandle = <0x73>;
		phandle = <0x73>;
	};

	accdet {
		compatible = "mediatek,pmic-accdet";
		linux,phandle = <0x74>;
		phandle = <0x74>;
	};

	fingerprint {
		compatible = "mediatek,goodix-fp";
		linux,phandle = <0x75>;
		phandle = <0x75>;
	};

	mt6357_gauge {
		compatible = "mediatek,mt6357_gauge";
		gauge_name = "gauge";
		alias_name = "mt6357";
	};

	gauge_timer {
		compatible = "mediatek,gauge_timer_service";
	};

	battery {
		compatible = "mediatek,bat_gm30";
		DIFFERENCE_FULLOCV_ITH = <0xc8>;
		SHUTDOWN_1_TIME = <0x5>;
		KEEP_100_PERCENT = <0x1>;
		R_FG_VALUE = <0xa>;
		EMBEDDED_SEL = <0x1>;
		PMIC_SHUTDOWN_CURRENT = <0x14>;
		FG_METER_RESISTANCE = <0x4b>;
		CAR_TUNE_VALUE = <0x64>;
		PMIC_MIN_VOL = <0x82dc>;
		POWERON_SYSTEM_IBOOT = <0x1f4>;
		SHUTDOWN_GAUGE0_VOLTAGE = <0x84d0>;
		TEMPERATURE_T0 = <0x32>;
		TEMPERATURE_T1 = <0x19>;
		TEMPERATURE_T2 = <0xa>;
		TEMPERATURE_T3 = <0x0>;
		TEMPERATURE_T4 = <0xfffffff6>;
		g_FG_PSEUDO100_T0 = <0x64>;
		g_FG_PSEUDO100_T1 = <0x64>;
		g_FG_PSEUDO100_T2 = <0x64>;
		g_FG_PSEUDO100_T3 = <0x64>;
		g_FG_PSEUDO100_T4 = <0x64>;
		Q_MAX_SYS_VOLTAGE_BAT0 = <0xd16>;
		Q_MAX_SYS_VOLTAGE_BAT1 = <0xd16>;
		Q_MAX_SYS_VOLTAGE_BAT2 = <0xd16>;
		Q_MAX_SYS_VOLTAGE_BAT3 = <0xd16>;
		battery0_name = "JIADE_VK";
		battery0_profile_t0_num = <0x64>;
		battery0_profile_t0 = <0x0 0xaad2 0x410 0x19f 0xaa34 0x410 0x33e 0xa9a4 0x410 0x4dd 0xa91c 0x40b 0x67c 0xa89a 0x409 0x81b 0xa81e 0x40f 0x9ba 0xa7a4 0x406 0xb59 0xa728 0x416 0xcf8 0xa6b1 0x420 0xe97 0xa639 0x41b 0x1035 0xa5bc 0x410 0x11d4 0xa541 0x411 0x1373 0xa4cd 0x419 0x1512 0xa458 0x41a 0x16b1 0xa3e4 0x420 0x1850 0xa36c 0x424 0x19ef 0xa2f2 0x421 0x1b8e 0xa27e 0x41b 0x1d2d 0xa20c 0x423 0x1ecc 0xa198 0x41d 0x206b 0xa129 0x425 0x220a 0xa0be 0x42a 0x23a9 0xa052 0x426 0x2548 0x9fe5 0x42e 0x26e7 0x9f71 0x42e 0x2886 0x9f0b 0x435 0x2a25 0x9ea2 0x438 0x2bc4 0x9e3a 0x438 0x2d63 0x9dd6 0x43a 0x2f02 0x9d73 0x442 0x30a0 0x9d1a 0x442 0x323f 0x9cb8 0x442 0x33de 0x9c59 0x44c 0x357d 0x9c01 0x459 0x371c 0x9bae 0x462 0x38bb 0x9b5b 0x46a 0x3a5a 0x9b08 0x482 0x3bf9 0x9ab5 0x48e 0x3d98 0x9a62 0x4a0 0x3f37 0x9a12 0x4b6 0x40d6 0x99c6 0x4c9 0x4275 0x9973 0x4eb 0x4414 0x990b 0x4ec 0x45b3 0x9881 0x4a9 0x4752 0x97f4 0x460 0x48f1 0x977f 0x433 0x4a90 0x972d 0x423 0x4c2f 0x96e3 0x41b 0x4dce 0x96a0 0x412 0x4f6d 0x9663 0x410 0x510b 0x962d 0x418 0x52aa 0x95fb 0x422 0x5449 0x95ca 0x419 0x55e8 0x9598 0x411 0x5787 0x9567 0x417 0x5926 0x953b 0x41f 0x5ac5 0x9511 0x420 0x5c64 0x94e8 0x418 0x5e03 0x94bf 0x411 0x5fa2 0x949d 0x421 0x6141 0x947c 0x42b 0x62e0 0x945b 0x42e 0x647f 0x943a 0x432 0x661e 0x9419 0x43a 0x67bd 0x93f8 0x442 0x695c 0x93df 0x44a 0x6afb 0x93c6 0x453 0x6c9a 0x93ae 0x45b 0x6e39 0x9391 0x463 0x6fd8 0x936d 0x466 0x7176 0x933c 0x44d 0x7315 0x92ea 0x414 0x74b4 0x92aa 0x40c 0x7653 0x9279 0x415 0x77f2 0x924f 0x41d 0x7991 0x9226 0x422 0x7b30 0x91fc 0x411 0x7ccf 0x91d3 0x418 0x7e6e 0x91b0 0x414 0x800d 0x918f 0x418 0x81ac 0x916b 0x429 0x834b 0x913f 0x436 0x84ea 0x90fd 0x426 0x8689 0x90bb 0x415 0x8828 0x9084 0x427 0x89c7 0x9042 0x42c 0x8b66 0x8ff3 0x413 0x8d05 0x8fb5 0x3fd 0x8ea4 0x8fad 0x40e 0x9043 0x8fa5 0x426 0x91e1 0x8f97 0x44e 0x9380 0x8f83 0x487 0x951f 0x8f5b 0x4be 0x96be 0x8ef9 0x4cc 0x985d 0x8d83 0x481 0x99fc 0x8b71 0x496 0x9b9b 0x88a9 0x4e3 0x9d3a 0x8481 0x5be 0x9ed9 0x800c 0x6f4 0xa078 0x800c 0x6f4>;
		battery0_profile_t1_num = <0x64>;
		battery0_profile_t1 = <0x0 0xab22 0x55a 0x19f 0xaa7c 0x55a 0x33e 0xa9ea 0x553 0x4dd 0xa962 0x54b 0x67c 0xa8e0 0x546 0x81b 0xa863 0x545 0x9ba 0xa7e0 0x53c 0xb59 0xa764 0x53c 0xcf8 0xa6e7 0x53c 0xe97 0xa66f 0x538 0x1035 0xa5f8 0x535 0x11d4 0xa57d 0x53b 0x1373 0xa509 0x533 0x1512 0xa494 0x53a 0x16b1 0xa420 0x53c 0x1850 0xa3ac 0x540 0x19ef 0xa338 0x546 0x1b8e 0xa2c5 0x547 0x1d2d 0xa25b 0x54f 0x1ecc 0xa1e8 0x557 0x206b 0xa174 0x55a 0x220a 0xa104 0x55e 0x23a9 0xa098 0x568 0x2548 0xa02c 0x578 0x26e7 0x9fc0 0x56f 0x2886 0x9f5b 0x57c 0x2a25 0x9f12 0x5a8 0x2bc4 0x9eca 0x5cc 0x2d63 0x9e62 0x5ca 0x2f02 0x9dd5 0x5aa 0x30a0 0x9d32 0x5a2 0x323f 0x9ca7 0x5a7 0x33de 0x9c3b 0x5b4 0x357d 0x9bed 0x5cb 0x371c 0x9bb3 0x5ee 0x38bb 0x9b79 0x617 0x3a5a 0x9b3f 0x620 0x3bf9 0x9af8 0x62f 0x3d98 0x9aa8 0x640 0x3f37 0x9a55 0x653 0x40d6 0x9a02 0x668 0x4275 0x99af 0x668 0x4414 0x9947 0x651 0x45b3 0x98d5 0x61a 0x4752 0x985d 0x5ce 0x48f1 0x97e3 0x57b 0x4a90 0x9772 0x52e 0x4c2f 0x971f 0x50d 0x4dce 0x96d4 0x502 0x4f6d 0x9695 0x4f4 0x510b 0x965b 0x4ec 0x52aa 0x9623 0x4ec 0x5449 0x95f2 0x4ec 0x55e8 0x95c0 0x4ec 0x5787 0x958f 0x4ec 0x5926 0x9563 0x4ec 0x5ac5 0x9539 0x4ec 0x5c64 0x9512 0x4f0 0x5e03 0x94f1 0x500 0x5fa2 0x94cf 0x500 0x6141 0x94a7 0x500 0x62e0 0x9483 0x500 0x647f 0x9465 0x504 0x661e 0x944b 0x50c 0x67bd 0x942a 0x514 0x695c 0x9411 0x51c 0x6afb 0x93ff 0x525 0x6c9a 0x93e5 0x528 0x6e39 0x93c7 0x52b 0x6fd8 0x93af 0x532 0x7176 0x939f 0x532 0x7315 0x937e 0x522 0x74b4 0x935d 0x511 0x7653 0x933b 0x4f7 0x77f2 0x931a 0x4df 0x7991 0x92f8 0x4d8 0x7b30 0x92ce 0x4d8 0x7ccf 0x92ad 0x4e0 0x7e6e 0x9286 0x4dc 0x800d 0x9261 0x4e0 0x81ac 0x9240 0x4ec 0x834b 0x921c 0x4ec 0x84ea 0x91e2 0x4ec 0x8689 0x91a8 0x4ec 0x8828 0x916e 0x4f7 0x89c7 0x9134 0x508 0x8b66 0x90f1 0x512 0x8d05 0x9098 0x509 0x8ea4 0x905e 0x4f8 0x9043 0x9048 0x504 0x91e1 0x903d 0x520 0x9380 0x9031 0x540 0x951f 0x901e 0x569 0x96be 0x9004 0x5ab 0x985d 0x8fa0 0x5e6 0x99fc 0x8e4e 0x5e2 0x9b9b 0x8c53 0x60f 0x9d3a 0x8997 0x68e 0x9ed9 0x8584 0x7e3 0xa078 0x7ed6 0xb7c>;
		battery0_profile_t2_num = <0x64>;
		battery0_profile_t2 = <0x0 0xab22 0x55a 0x19f 0xaa7c 0x55a 0x33e 0xa9ea 0x553 0x4dd 0xa962 0x54b 0x67c 0xa8e0 0x546 0x81b 0xa863 0x545 0x9ba 0xa7e0 0x53c 0xb59 0xa764 0x53c 0xcf8 0xa6e7 0x53c 0xe97 0xa66f 0x538 0x1035 0xa5f8 0x535 0x11d4 0xa57d 0x53b 0x1373 0xa509 0x533 0x1512 0xa494 0x53a 0x16b1 0xa420 0x53c 0x1850 0xa3ac 0x540 0x19ef 0xa338 0x546 0x1b8e 0xa2c5 0x547 0x1d2d 0xa25b 0x54f 0x1ecc 0xa1e8 0x557 0x206b 0xa174 0x55a 0x220a 0xa104 0x55e 0x23a9 0xa098 0x568 0x2548 0xa02c 0x578 0x26e7 0x9fc0 0x56f 0x2886 0x9f5b 0x57c 0x2a25 0x9f12 0x5a8 0x2bc4 0x9eca 0x5cc 0x2d63 0x9e62 0x5ca 0x2f02 0x9dd5 0x5aa 0x30a0 0x9d32 0x5a2 0x323f 0x9ca7 0x5a7 0x33de 0x9c3b 0x5b4 0x357d 0x9bed 0x5cb 0x371c 0x9bb3 0x5ee 0x38bb 0x9b79 0x617 0x3a5a 0x9b3f 0x620 0x3bf9 0x9af8 0x62f 0x3d98 0x9aa8 0x640 0x3f37 0x9a55 0x653 0x40d6 0x9a02 0x668 0x4275 0x99af 0x668 0x4414 0x9947 0x651 0x45b3 0x98d5 0x61a 0x4752 0x985d 0x5ce 0x48f1 0x97e3 0x57b 0x4a90 0x9772 0x52e 0x4c2f 0x971f 0x50d 0x4dce 0x96d4 0x502 0x4f6d 0x9695 0x4f4 0x510b 0x965b 0x4ec 0x52aa 0x9623 0x4ec 0x5449 0x95f2 0x4ec 0x55e8 0x95c0 0x4ec 0x5787 0x958f 0x4ec 0x5926 0x9563 0x4ec 0x5ac5 0x9539 0x4ec 0x5c64 0x9512 0x4f0 0x5e03 0x94f1 0x500 0x5fa2 0x94cf 0x500 0x6141 0x94a7 0x500 0x62e0 0x9483 0x500 0x647f 0x9465 0x504 0x661e 0x944b 0x50c 0x67bd 0x942a 0x514 0x695c 0x9411 0x51c 0x6afb 0x93ff 0x525 0x6c9a 0x93e5 0x528 0x6e39 0x93c7 0x52b 0x6fd8 0x93af 0x532 0x7176 0x939f 0x532 0x7315 0x937e 0x522 0x74b4 0x935d 0x511 0x7653 0x933b 0x4f7 0x77f2 0x931a 0x4df 0x7991 0x92f8 0x4d8 0x7b30 0x92ce 0x4d8 0x7ccf 0x92ad 0x4e0 0x7e6e 0x9286 0x4dc 0x800d 0x9261 0x4e0 0x81ac 0x9240 0x4ec 0x834b 0x921c 0x4ec 0x84ea 0x91e2 0x4ec 0x8689 0x91a8 0x4ec 0x8828 0x916e 0x4f7 0x89c7 0x9134 0x508 0x8b66 0x90f1 0x512 0x8d05 0x9098 0x509 0x8ea4 0x905e 0x4f8 0x9043 0x9048 0x504 0x91e1 0x903d 0x520 0x9380 0x9031 0x540 0x951f 0x901e 0x569 0x96be 0x9004 0x5ab 0x985d 0x8fa0 0x5e6 0x99fc 0x8e4e 0x5e2 0x9b9b 0x8c53 0x60f 0x9d3a 0x8997 0x68e 0x9ed9 0x8584 0x7e3 0xa078 0x7ed6 0xb7c>;
		battery0_profile_t3_num = <0x64>;
		battery0_profile_t3 = <0x0 0xab0e 0xf1e 0x19f 0xaa47 0xf1e 0x33e 0xa99a 0xf11 0x4dd 0xa8fe 0xeed 0x67c 0xa86f 0xec1 0x81b 0xa7eb 0xea0 0x9ba 0xa768 0xe80 0xb59 0xa6ec 0xe6e 0xcf8 0xa675 0xe51 0xe97 0xa5fd 0xe30 0x1035 0xa583 0xe14 0x11d4 0xa50f 0xe03 0x1373 0xa49b 0xdea 0x1512 0xa42e 0xdd9 0x16b1 0xa3bc 0xdce 0x1850 0xa34c 0xdc1 0x19ef 0xa2e0 0xdb9 0x1b8e 0xa275 0xdc1 0x1d2d 0xa20b 0xdc9 0x1ecc 0xa198 0xdc3 0x206b 0xa129 0xdc0 0x220a 0xa0be 0xdb8 0x23a9 0xa056 0xdae 0x2548 0x9ffc 0xdb8 0x26e7 0x9fb1 0xde2 0x2886 0x9f6d 0xe4b 0x2a25 0x9f16 0xe8f 0x2bc4 0x9e98 0xe90 0x2d63 0x9df5 0xe50 0x2f02 0x9d3f 0xde6 0x30a0 0x9c9c 0xd9c 0x323f 0x9c18 0xd6d 0x33de 0x9baa 0xd57 0x357d 0x9b4d 0xd4f 0x371c 0x9afd 0xd4b 0x38bb 0x9abb 0xd5c 0x3a5a 0x9a79 0xd54 0x3bf9 0x9a36 0xd52 0x3d98 0x99e6 0xd35 0x3f37 0x998a 0xd04 0x40d6 0x992e 0xcd0 0x4275 0x98ca 0xc96 0x4414 0x9868 0xc5d 0x45b3 0x9811 0xc2a 0x4752 0x97ba 0xbf8 0x48f1 0x9764 0xbd1 0x4a90 0x9719 0xbbf 0x4c2f 0x96cf 0xba6 0x4dce 0x9693 0xba4 0x4f6d 0x9653 0xb9e 0x510b 0x9619 0xb9a 0x52aa 0x95e7 0xb9c 0x5449 0x95b6 0xba4 0x55e8 0x9584 0xba4 0x5787 0x955a 0xba4 0x5926 0x9531 0xbb4 0x5ac5 0x9507 0xbc6 0x5c64 0x94e0 0xbcc 0x5e03 0x94bf 0xbcd 0x5fa2 0x949d 0xbe6 0x6141 0x947c 0xbf1 0x62e0 0x9460 0xbfe 0x647f 0x9444 0xc0f 0x661e 0x9424 0xc1c 0x67bd 0x940c 0xc1c 0x695c 0x93fb 0xc2d 0x6afb 0x93eb 0xc44 0x6c9a 0x93da 0xc58 0x6e39 0x93cd 0xc68 0x6fd8 0x93c5 0xc7c 0x7176 0x93bc 0xc9d 0x7315 0x93ac 0xcb6 0x74b4 0x93a2 0xce8 0x7653 0x9390 0xd10 0x77f2 0x9377 0xd2c 0x7991 0x935e 0xd51 0x7b30 0x9345 0xd8b 0x7ccf 0x9325 0xdbd 0x7e6e 0x92fe 0xdf4 0x800d 0x92d5 0xe3e 0x81ac 0x92a9 0xe9a 0x834b 0x9276 0xef8 0x84ea 0x923c 0xf75 0x8689 0x91f3 0xff1 0x8828 0x91b4 0x108a 0x89c7 0x916e 0x1138 0x8b66 0x911d 0x11f6 0x8d05 0x90d4 0x12cb 0x8ea4 0x90a3 0x13e5 0x9043 0x9078 0x1539 0x91e1 0x905a 0x16e2 0x9380 0x903a 0x18e5 0x951f 0x9009 0x1b53 0x96be 0x8fbc 0x1e52 0x985d 0x8f0d 0x21d3 0x99fc 0x8da1 0x259e 0x9b9b 0x8b7b 0x2b3a 0x9d3a 0x887e 0x333a 0x9ed9 0x858e 0x3b10 0xa078 0x858e 0x3b10>;
		battery0_profile_t4_num = <0x64>;
		battery0_profile_t4 = <0x0 0xab04 0x2238 0x19f 0xaa1c 0x2238 0x33e 0xa954 0x223f 0x4dd 0xa8a4 0x220c 0x67c 0xa804 0x21b4 0x81b 0xa773 0x2160 0x9ba 0xa6f0 0x2106 0xb59 0xa66c 0x20bb 0xcf8 0xa5e7 0x206a 0xe97 0xa562 0x2013 0x1035 0xa4e0 0x1fba 0x11d4 0xa465 0x1f69 0x1373 0xa3f1 0x1f27 0x1512 0xa37c 0x1ee5 0x16b1 0xa30e 0x1eae 0x1850 0xa29e 0x1e78 0x19ef 0xa22a 0x1e3b 0x1b8e 0xa1b7 0x1dfc 0x1d2d 0xa14d 0x1dd3 0x1ecc 0xa0da 0x1d94 0x206b 0xa077 0x1d68 0x220a 0xa023 0x1d66 0x23a9 0x9fd4 0x1d82 0x2548 0x9f78 0x1d92 0x26e7 0x9f0c 0x1d89 0x2886 0x9e76 0x1d1e 0x2a25 0x9dc8 0x1c81 0x2bc4 0x9d15 0x1bde 0x2d63 0x9c6e 0x1b56 0x2f02 0x9be3 0x1afc 0x30a0 0x9b79 0x1ac3 0x323f 0x9b0d 0x1a97 0x33de 0x9ab0 0x1a81 0x357d 0x9a64 0x1a75 0x371c 0x9a20 0x1a65 0x38bb 0x99d5 0x1a54 0x3a5a 0x998b 0x1a54 0x3bf9 0x9939 0x1a3a 0x3d98 0x98e6 0x1a19 0x3f37 0x9893 0x19f8 0x40d6 0x9840 0x19d8 0x4275 0x97ed 0x19bf 0x4414 0x97a4 0x199f 0x45b3 0x9759 0x197e 0x4752 0x9713 0x195d 0x48f1 0x96d1 0x1943 0x4a90 0x968f 0x193b 0x4c2f 0x9655 0x1933 0x4dce 0x961b 0x1923 0x4f6d 0x95e7 0x1918 0x510b 0x95b1 0x190c 0x52aa 0x957c 0x1905 0x5449 0x9552 0x1915 0x55e8 0x9529 0x191d 0x5787 0x9500 0x192c 0x5926 0x94d7 0x193d 0x5ac5 0x94b1 0x1955 0x5c64 0x9490 0x1976 0x5e03 0x946f 0x1998 0x5fa2 0x9456 0x19c1 0x6141 0x9444 0x19e4 0x62e0 0x942e 0x1a0f 0x647f 0x941c 0x1a48 0x661e 0x9412 0x1a8d 0x67bd 0x9402 0x1ad7 0x695c 0x93fa 0x1b2a 0x6afb 0x93eb 0x1b7c 0x6c9a 0x93da 0x1bd8 0x6e39 0x93cd 0x1c3c 0x6fd8 0x93c3 0x1ca6 0x7176 0x93b3 0x1d33 0x7315 0x93a2 0x1dc0 0x74b4 0x9391 0x1e5a 0x7653 0x937c 0x1f06 0x77f2 0x9363 0x1fc5 0x7991 0x9349 0x2098 0x7b30 0x9328 0x2181 0x7ccf 0x9307 0x2271 0x7e6e 0x92e0 0x237c 0x800d 0x92b7 0x24a9 0x81ac 0x928b 0x25f9 0x834b 0x9258 0x276b 0x84ea 0x921e 0x290a 0x8689 0x91dd 0x2add 0x8828 0x919a 0x2ce3 0x89c7 0x9158 0x2f0f 0x8b66 0x9115 0x3163 0x8d05 0x90d4 0x33f1 0x8ea4 0x909a 0x3667 0x9043 0x906e 0x3879 0x91e1 0x9045 0x3a7a 0x9380 0x901c 0x3c6d 0x951f 0x8feb 0x3e4b 0x96be 0x8f9d 0x401c 0x985d 0x8ede 0x41fd 0x99fc 0x8d68 0x444b 0x9b9b 0x8b30 0x4835 0x9d3a 0x87f1 0x4eef 0x9ed9 0x849e 0x5668 0xa078 0x849e 0x5668>;
		battery1_name = "FENGHUA_FHPV";
		battery1_profile_t0_num = <0x64>;
		battery1_profile_t0 = <0x0 0xaad2 0x4d8 0x1a2 0xaa29 0x4d8 0x343 0xa99e 0x4d7 0x4e5 0xa917 0x4ce 0x687 0xa89f 0x4d1 0x828 0xa820 0x4d5 0x9ca 0xa7a4 0x4ce 0xb6c 0xa72e 0x4ce 0xd0d 0xa6b3 0x4ce 0xeaf 0xa639 0x4da 0x1051 0xa5c3 0x4e2 0x11f2 0xa545 0x4e2 0x1394 0xa4cd 0x4da 0x1536 0xa457 0x4e1 0x16d7 0xa3e4 0x4e2 0x1879 0xa36f 0x4e2 0x1a1b 0xa2f9 0x4d9 0x1bbd 0xa283 0x4e2 0x1d5e 0xa20d 0x4e0 0x1f00 0xa197 0x4de 0x20a2 0xa125 0x4f0 0x2243 0xa0b6 0x4f2 0x23e5 0xa045 0x4f1 0x2587 0x9fd6 0x4f0 0x2728 0x9f67 0x4ec 0x28ca 0x9efc 0x4fa 0x2a6c 0x9e91 0x500 0x2c0d 0x9e26 0x500 0x2daf 0x9dc4 0x509 0x2f51 0x9d5a 0x50a 0x30f2 0x9cf9 0x50b 0x3294 0x9c99 0x514 0x3436 0x9c39 0x516 0x35d7 0x9bda 0x520 0x3779 0x9b7a 0x52b 0x391b 0x9b1e 0x532 0x3abc 0x9ac8 0x53b 0x3c5e 0x9a72 0x550 0x3e00 0x9a17 0x560 0x3fa1 0x99bd 0x56b 0x4143 0x9960 0x575 0x42e5 0x98f7 0x578 0x4486 0x9886 0x55e 0x4628 0x9807 0x52c 0x47ca 0x9791 0x500 0x496b 0x9727 0x4e3 0x4b0d 0x96dc 0x4eb 0x4caf 0x9691 0x4de 0x4e50 0x964c 0x4d1 0x4ff2 0x9613 0x4d8 0x5194 0x95d3 0x4d4 0x5336 0x959c 0x4d3 0x54d7 0x9566 0x4d2 0x5679 0x9533 0x4d4 0x581b 0x9501 0x4d8 0x59bc 0x94d3 0x4d8 0x5b5e 0x94a8 0x4d0 0x5d00 0x947d 0x4e0 0x5ea1 0x9452 0x4e2 0x6043 0x9428 0x4ec 0x61e5 0x9407 0x4ec 0x6386 0x93de 0x4ec 0x6528 0x93be 0x4ec 0x66ca 0x939e 0x4ef 0x686b 0x937e 0x4fa 0x6a0d 0x935d 0x500 0x6baf 0x933d 0x506 0x6d50 0x931d 0x50a 0x6ef2 0x92f6 0x50a 0x7094 0x92cb 0x502 0x7235 0x9287 0x4e7 0x73d7 0x923c 0x4d0 0x7579 0x9205 0x4ce 0x771a 0x91da 0x4d8 0x78bc 0x91ae 0x4d7 0x7a5e 0x917a 0x4ce 0x7bff 0x914f 0x4cb 0x7da1 0x9128 0x4c7 0x7f43 0x9104 0x4d2 0x80e4 0x90de 0x4dd 0x8286 0x90b8 0x4e7 0x8428 0x9081 0x4e6 0x85c9 0x9041 0x4d4 0x876b 0x9008 0x4dd 0x890d 0x8fca 0x4ea 0x8aaf 0x8f8a 0x4ec 0x8c50 0x8f36 0x4bb 0x8df2 0x8f16 0x4bb 0x8f94 0x8f0b 0x4d3 0x9135 0x8f00 0x4ff 0x92d7 0x8ef3 0x535 0x9479 0x8ed7 0x56e 0x961a 0x8e84 0x57e 0x97bc 0x8d90 0x539 0x995e 0x8be2 0x524 0x9aff 0x89a0 0x544 0x9ca1 0x869b 0x578 0x9e43 0x81ef 0x60f 0x9fe4 0x8098 0x640 0xa186 0x8098 0x640>;
		battery1_profile_t1_num = <0x64>;
		battery1_profile_t1 = <0x0 0xab4a 0x622 0x1a2 0xaa77 0x623 0x343 0xa9d8 0x62c 0x4e5 0xa946 0x62a 0x687 0xa8c3 0x61f 0x828 0xa83b 0x618 0x9ca 0xa7bf 0x618 0xb6c 0xa744 0x60e 0xd0d 0xa6ca 0x604 0xeaf 0xa64d 0x604 0x1051 0xa5d4 0x5fd 0x11f2 0xa55e 0x602 0x1394 0xa4e8 0x5fb 0x1536 0xa473 0x603 0x16d7 0xa3fd 0x604 0x1879 0xa388 0x5fa 0x1a1b 0xa31b 0x5fa 0x1bbd 0xa2a5 0x5fa 0x1d5e 0xa232 0x600 0x1f00 0xa1c4 0x60b 0x20a2 0xa156 0x60c 0x2243 0xa0ec 0x618 0x23e5 0xa076 0x612 0x2587 0xa00d 0x621 0x2728 0x9f9f 0x625 0x28ca 0x9f31 0x62a 0x2a6c 0x9ec5 0x62c 0x2c0d 0x9e6d 0x63e 0x2daf 0x9e2b 0x667 0x2f51 0x9dde 0x67a 0x30f2 0x9d61 0x65b 0x3294 0x9cb8 0x648 0x3436 0x9c1f 0x645 0x35d7 0x9ba6 0x657 0x3779 0x9b47 0x66a 0x391b 0x9b06 0x686 0x3abc 0x9ad0 0x69b 0x3c5e 0x9a94 0x6a4 0x3e00 0x9a46 0x696 0x3fa1 0x99f1 0x6a7 0x4143 0x9993 0x6a6 0x42e5 0x9932 0x69b 0x4486 0x98c8 0x67d 0x4628 0x985c 0x65b 0x47ca 0x97e9 0x627 0x496b 0x9787 0x5fc 0x4b0d 0x9721 0x5d7 0x4caf 0x96cf 0x5c5 0x4e50 0x9688 0x5be 0x4ff2 0x9647 0x5b9 0x5194 0x9607 0x5af 0x5336 0x95ce 0x5aa 0x54d7 0x9599 0x5aa 0x5679 0x9563 0x59b 0x581b 0x9536 0x59e 0x59bc 0x9502 0x5a0 0x5b5e 0x94d6 0x5b3 0x5d00 0x94ab 0x5a0 0x5ea1 0x9480 0x5aa 0x6043 0x9457 0x5aa 0x61e5 0x9437 0x5af 0x6386 0x9414 0x5be 0x6528 0x93ed 0x5be 0x66ca 0x93cd 0x5be 0x686b 0x93ad 0x5be 0x6a0d 0x938c 0x5ca 0x6baf 0x9373 0x5d9 0x6d50 0x934f 0x5cd 0x6ef2 0x9334 0x5d0 0x7094 0x9316 0x5c9 0x7235 0x92f6 0x5bf 0x73d7 0x92e0 0x5be 0x7579 0x92bf 0x5bb 0x771a 0x9295 0x5a2 0x78bc 0x9275 0x5a5 0x7a5e 0x9252 0x596 0x7bff 0x922b 0x59a 0x7da1 0x9206 0x59c 0x7f43 0x91e1 0x596 0x80e4 0x91c1 0x59c 0x8286 0x919a 0x5a7 0x8428 0x9176 0x5b8 0x85c9 0x9146 0x5be 0x876b 0x9108 0x5be 0x890d 0x90d1 0x5be 0x8aaf 0x909c 0x5c8 0x8c50 0x905b 0x5c0 0x8df2 0x900e 0x5cf 0x8f94 0x8fc3 0x5be 0x9135 0x8fa6 0x5c1 0x92d7 0x8f94 0x5cf 0x9479 0x8f85 0x5ed 0x961a 0x8f70 0x613 0x97bc 0x8f4f 0x644 0x995e 0x8ef7 0x671 0x9aff 0x8deb 0x65f 0x9ca1 0x8c2e 0x664 0x9e43 0x89cb 0x69b 0x9fe4 0x8673 0x70a 0xa186 0x811a 0x80c>;
		battery1_profile_t2_num = <0x64>;
		battery1_profile_t2 = <0x0 0xab7c 0x910 0x1a2 0xaae7 0x911 0x343 0xaa67 0x91b 0x4e5 0xa9ea 0x922 0x687 0xa969 0x91a 0x828 0xa8e8 0x913 0x9ca 0xa868 0x902 0xb6c 0xa7ed 0x8f7 0xd0d 0xa774 0x8ed 0xeaf 0xa6f9 0x8e2 0x1051 0xa67d 0x8de 0x11f2 0xa604 0x8de 0x1394 0xa588 0x8ce 0x1536 0xa511 0x8d2 0x16d7 0xa49b 0x8c2 0x1879 0xa425 0x8c0 0x1a1b 0xa3b0 0x8c1 0x1bbd 0xa33d 0x8cb 0x1d5e 0xa2c7 0x8d4 0x1f00 0xa251 0x8d4 0x20a2 0xa1de 0x8da 0x2243 0xa170 0x8e8 0x23e5 0xa0fc 0x8ec 0x2587 0xa087 0x8f7 0x2728 0xa017 0x8fc 0x28ca 0x9fb2 0x8fc 0x2a6c 0x9f5a 0x918 0x2c0d 0x9f14 0x952 0x2daf 0x9ec3 0x98a 0x2f51 0x9e37 0x977 0x30f2 0x9d71 0x943 0x3294 0x9cab 0x906 0x3436 0x9c02 0x8ef 0x35d7 0x9b7a 0x8cf 0x3779 0x9b09 0x8b4 0x391b 0x9aaf 0x8a3 0x3abc 0x9a66 0x88b 0x3c5e 0x9a1b 0x87c 0x3e00 0x99cb 0x861 0x3fa1 0x9975 0x83b 0x4143 0x991a 0x817 0x42e5 0x98bb 0x7f1 0x4486 0x9862 0x7d5 0x4628 0x980c 0x7c0 0x47ca 0x97c0 0x7b3 0x496b 0x9776 0x7a9 0x4b0d 0x972c 0x79e 0x4caf 0x96ec 0x79e 0x4e50 0x96b5 0x79d 0x4ff2 0x9675 0x794 0x5194 0x9639 0x78f 0x5336 0x9603 0x787 0x54d7 0x95ce 0x790 0x5679 0x959d 0x78f 0x581b 0x956d 0x794 0x59bc 0x953e 0x79a 0x5b5e 0x9513 0x7a5 0x5d00 0x94f0 0x7a1 0x5ea1 0x94c8 0x7a6 0x6043 0x949e 0x7a8 0x61e5 0x947c 0x7a8 0x6386 0x945c 0x7b2 0x6528 0x9432 0x7a9 0x66ca 0x9412 0x7b3 0x686b 0x93f3 0x7ba 0x6a0d 0x93d5 0x7b5 0x6baf 0x93bc 0x7b9 0x6d50 0x93a0 0x7b6 0x6ef2 0x938b 0x7bc 0x7094 0x9376 0x7bc 0x7235 0x9360 0x7c2 0x73d7 0x934b 0x7cd 0x7579 0x932e 0x7c9 0x771a 0x930f 0x7ce 0x78bc 0x92ef 0x7d0 0x7a5e 0x92c6 0x7d9 0x7bff 0x92a5 0x7ee 0x7da1 0x9283 0x803 0x7f43 0x9250 0x80f 0x80e4 0x9222 0x82d 0x8286 0x91e2 0x843 0x8428 0x91a4 0x85e 0x85c9 0x916c 0x885 0x876b 0x9128 0x8a5 0x890d 0x90d8 0x8c5 0x8aaf 0x9093 0x8e5 0x8c50 0x906b 0x918 0x8df2 0x9052 0x958 0x8f94 0x9035 0x9a7 0x9135 0x9015 0xa15 0x92d7 0x8fd1 0xab8 0x9479 0x8f56 0xb94 0x961a 0x8e51 0xc1e 0x97bc 0x8c76 0xcb7 0x995e 0x89d0 0xe0c 0x9aff 0x85f2 0x1077 0x9ca1 0x8200 0x134c 0x9e43 0x8200 0x134c 0x9fe4 0x8200 0x134c 0xa186 0x8200 0x134c>;
		battery1_profile_t3_num = <0x64>;
		battery1_profile_t3 = <0x0 0xaba4 0x116c 0x1a2 0xaabb 0x1185 0x343 0xa9f2 0x12c7 0x4e5 0xa944 0x12ab 0x687 0xa8a3 0x1270 0x828 0xa809 0x1245 0x9ca 0xa782 0x121e 0xb6c 0xa703 0x11fe 0xd0d 0xa684 0x11d9 0xeaf 0xa604 0x11b4 0x1051 0xa58a 0x1187 0x11f2 0xa50c 0x1160 0x1394 0xa496 0x1139 0x1536 0xa421 0x1128 0x16d7 0xa3b4 0x110b 0x1879 0xa33f 0x10f4 0x1a1b 0xa2d4 0x10e9 0x1bbd 0xa261 0x10d4 0x1d5e 0xa1ed 0x10c2 0x1f00 0xa17f 0x10b8 0x20a2 0xa10c 0x1094 0x2243 0xa09e 0x1077 0x23e5 0xa037 0x105e 0x2587 0x9fe2 0x1077 0x2728 0x9f86 0x10b8 0x28ca 0x9f26 0x10fd 0x2a6c 0x9eb9 0x10f6 0x2c0d 0x9e2d 0x10a5 0x2daf 0x9d7e 0x105e 0x2f51 0x9cc8 0xfd5 0x30f2 0x9c1c 0xf66 0x3294 0x9b8a 0xeff 0x3436 0x9b0a 0xed3 0x35d7 0x9a97 0xe99 0x3779 0x9a3c 0xe86 0x391b 0x99f1 0xe6f 0x3abc 0x99a8 0xe5d 0x3c5e 0x995d 0xe7e 0x3e00 0x990d 0xe6f 0x3fa1 0x98bd 0xe4f 0x4143 0x986d 0xe36 0x42e5 0x981e 0xe20 0x4486 0x97d4 0xe0b 0x4628 0x9789 0xdfe 0x47ca 0x9746 0xdfc 0x496b 0x9708 0xdf3 0x4b0d 0x96be 0xdf2 0x4caf 0x9687 0xdf1 0x4e50 0x9649 0xde9 0x4ff2 0x9611 0xdf2 0x5194 0x95d5 0xdef 0x5336 0x95a3 0xdef 0x54d7 0x9574 0xdfc 0x5679 0x9543 0xdfc 0x581b 0x9513 0xe01 0x59bc 0x94ea 0xe06 0x5b5e 0x94c3 0xe13 0x5d00 0x9499 0xe1a 0x5ea1 0x9476 0xe22 0x6043 0x9456 0xe35 0x61e5 0x9436 0xe41 0x6386 0x9416 0xe4c 0x6528 0x9401 0xe62 0x66ca 0x93f5 0xe82 0x686b 0x93e0 0xe9e 0x6a0d 0x93cd 0xeb3 0x6baf 0x93c0 0xee5 0x6d50 0x93aa 0xf10 0x6ef2 0x9399 0xf43 0x7094 0x9385 0xf8d 0x7235 0x936a 0xfd1 0x73d7 0x9355 0x101a 0x7579 0x9338 0x1077 0x771a 0x9320 0x10de 0x78bc 0x9303 0x1159 0x7a5e 0x92da 0x11d0 0x7bff 0x92af 0x123c 0x7da1 0x9284 0x12d1 0x7f43 0x9259 0x1364 0x80e4 0x9223 0x13fc 0x8286 0x91ec 0x149f 0x8428 0x91ae 0x154d 0x85c9 0x9172 0x1605 0x876b 0x9128 0x16cc 0x890d 0x90e7 0x17a7 0x8aaf 0x90ac 0x1893 0x8c50 0x9072 0x199d 0x8df2 0x9044 0x1ad1 0x8f94 0x9012 0x1c39 0x9135 0x8fdd 0x1dda 0x92d7 0x8f8c 0x1faa 0x9479 0x8efc 0x21cf 0x961a 0x8e0d 0x240f 0x97bc 0x8c94 0x26df 0x995e 0x8a79 0x2a65 0x9aff 0x8790 0x2ec9 0x9ca1 0x833b 0x36ae 0x9e43 0x7b83 0x4049 0x9fe4 0x7b5c 0x404c 0xa186 0x7b5c 0x404c>;
		battery1_profile_t4_num = <0x64>;
		battery1_profile_t4 = <0x0 0xab9a 0x1f0e 0x1a2 0xaaac 0x1f2d 0x343 0xa9a7 0x20b9 0x4e5 0xa8d0 0x209d 0x687 0xa812 0x205f 0x828 0xa75f 0x2026 0x9ca 0xa6b8 0x1fe6 0xb6c 0xa61e 0x1fab 0xd0d 0xa58a 0x1f71 0xeaf 0xa4fa 0x1f37 0x1051 0xa46e 0x1efa 0x11f2 0xa3e3 0x1ed0 0x1394 0xa35b 0x1e99 0x1536 0xa2e1 0x1e73 0x16d7 0xa259 0x1e53 0x1879 0xa1d7 0x1dd0 0x1a1b 0xa162 0x1da3 0x1bbd 0xa0f1 0x1d73 0x1d5e 0xa090 0x1d74 0x1f00 0xa030 0x1db7 0x20a2 0x9fc6 0x1de2 0x2243 0x9f3b 0x1dbb 0x23e5 0x9e99 0x1d6c 0x2587 0x9de8 0x1cd8 0x2728 0x9d38 0x1c34 0x28ca 0x9c9a 0x1baa 0x2a6c 0x9c0d 0x1b48 0x2c0d 0x9b92 0x1b02 0x2daf 0x9b25 0x1ae3 0x2f51 0x9ac3 0x1abc 0x30f2 0x9a62 0x1ab8 0x3294 0x9a19 0x1ac2 0x3436 0x99cf 0x1ac1 0x35d7 0x998b 0x1ab8 0x3779 0x9938 0x1ab8 0x391b 0x98ea 0x1ab8 0x3abc 0x989a 0x1aae 0x3c5e 0x984a 0x1a85 0x3e00 0x97ff 0x1a5e 0x3fa1 0x97b9 0x1a8c 0x4143 0x9775 0x1a8d 0x42e5 0x972e 0x1a6b 0x4486 0x96eb 0x1a68 0x4628 0x96ab 0x1a91 0x47ca 0x966a 0x1a7f 0x496b 0x9635 0x1a85 0x4b0d 0x9600 0x1aa4 0x4caf 0x95ca 0x1aaf 0x4e50 0x9596 0x1abe 0x4ff2 0x956b 0x1ae4 0x5194 0x9541 0x1af9 0x5336 0x9517 0x1b12 0x54d7 0x94f0 0x1b32 0x5679 0x94d0 0x1b57 0x581b 0x94b0 0x1b7c 0x59bc 0x9496 0x1bae 0x5b5e 0x9481 0x1bee 0x5d00 0x946b 0x1c27 0x5ea1 0x9456 0x1c65 0x6043 0x9449 0x1cac 0x61e5 0x9436 0x1d00 0x6386 0x9420 0x1d56 0x6528 0x940b 0x1dc1 0x66ca 0x93ff 0x1e2f 0x686b 0x93ea 0x1eb8 0x6a0d 0x93d5 0x1f48 0x6baf 0x93bc 0x1fe5 0x6d50 0x93a0 0x208b 0x6ef2 0x9386 0x2145 0x7094 0x936c 0x2208 0x7235 0x9351 0x22df 0x73d7 0x9330 0x23b5 0x7579 0x9318 0x24a1 0x771a 0x92f3 0x258b 0x78bc 0x92d1 0x267d 0x7a5e 0x92b1 0x2774 0x7bff 0x9287 0x287e 0x7da1 0x925c 0x2993 0x7f43 0x9232 0x2a94 0x80e4 0x9207 0x2bcb 0x8286 0x91dc 0x2cd6 0x8428 0x91ae 0x2e01 0x85c9 0x917d 0x2f2b 0x876b 0x914f 0x3052 0x890d 0x9119 0x3197 0x8aaf 0x90e9 0x3242 0x8c50 0x90b2 0x3387 0x8df2 0x9072 0x351f 0x8f94 0x9033 0x367e 0x9135 0x8fea 0x37e0 0x92d7 0x8f96 0x3902 0x9479 0x8f23 0x39fb 0x961a 0x8e9b 0x3ae2 0x97bc 0x8de1 0x3be1 0x995e 0x8cea 0x3c7b 0x9aff 0x8b9d 0x3e2e 0x9ca1 0x89cf 0x4041 0x9e43 0x8732 0x43bd 0x9fe4 0x82f2 0x4a6d 0xa186 0x7e5e 0x47cc>;
		battery2_name = "BATTERY_UNKNOW";
		battery2_profile_t0_num = <0x64>;
		battery2_profile_t0 = <0x0 0xaad2 0x410 0x19f 0xaa34 0x410 0x33e 0xa9a4 0x410 0x4dd 0xa91c 0x40b 0x67c 0xa89a 0x409 0x81b 0xa81e 0x40f 0x9ba 0xa7a4 0x406 0xb59 0xa728 0x416 0xcf8 0xa6b1 0x420 0xe97 0xa639 0x41b 0x1035 0xa5bc 0x410 0x11d4 0xa541 0x411 0x1373 0xa4cd 0x419 0x1512 0xa458 0x41a 0x16b1 0xa3e4 0x420 0x1850 0xa36c 0x424 0x19ef 0xa2f2 0x421 0x1b8e 0xa27e 0x41b 0x1d2d 0xa20c 0x423 0x1ecc 0xa198 0x41d 0x206b 0xa129 0x425 0x220a 0xa0be 0x42a 0x23a9 0xa052 0x426 0x2548 0x9fe5 0x42e 0x26e7 0x9f71 0x42e 0x2886 0x9f0b 0x435 0x2a25 0x9ea2 0x438 0x2bc4 0x9e3a 0x438 0x2d63 0x9dd6 0x43a 0x2f02 0x9d73 0x442 0x30a0 0x9d1a 0x442 0x323f 0x9cb8 0x442 0x33de 0x9c59 0x44c 0x357d 0x9c01 0x459 0x371c 0x9bae 0x462 0x38bb 0x9b5b 0x46a 0x3a5a 0x9b08 0x482 0x3bf9 0x9ab5 0x48e 0x3d98 0x9a62 0x4a0 0x3f37 0x9a12 0x4b6 0x40d6 0x99c6 0x4c9 0x4275 0x9973 0x4eb 0x4414 0x990b 0x4ec 0x45b3 0x9881 0x4a9 0x4752 0x97f4 0x460 0x48f1 0x977f 0x433 0x4a90 0x972d 0x423 0x4c2f 0x96e3 0x41b 0x4dce 0x96a0 0x412 0x4f6d 0x9663 0x410 0x510b 0x962d 0x418 0x52aa 0x95fb 0x422 0x5449 0x95ca 0x419 0x55e8 0x9598 0x411 0x5787 0x9567 0x417 0x5926 0x953b 0x41f 0x5ac5 0x9511 0x420 0x5c64 0x94e8 0x418 0x5e03 0x94bf 0x411 0x5fa2 0x949d 0x421 0x6141 0x947c 0x42b 0x62e0 0x945b 0x42e 0x647f 0x943a 0x432 0x661e 0x9419 0x43a 0x67bd 0x93f8 0x442 0x695c 0x93df 0x44a 0x6afb 0x93c6 0x453 0x6c9a 0x93ae 0x45b 0x6e39 0x9391 0x463 0x6fd8 0x936d 0x466 0x7176 0x933c 0x44d 0x7315 0x92ea 0x414 0x74b4 0x92aa 0x40c 0x7653 0x9279 0x415 0x77f2 0x924f 0x41d 0x7991 0x9226 0x422 0x7b30 0x91fc 0x411 0x7ccf 0x91d3 0x418 0x7e6e 0x91b0 0x414 0x800d 0x918f 0x418 0x81ac 0x916b 0x429 0x834b 0x913f 0x436 0x84ea 0x90fd 0x426 0x8689 0x90bb 0x415 0x8828 0x9084 0x427 0x89c7 0x9042 0x42c 0x8b66 0x8ff3 0x413 0x8d05 0x8fb5 0x3fd 0x8ea4 0x8fad 0x40e 0x9043 0x8fa5 0x426 0x91e1 0x8f97 0x44e 0x9380 0x8f83 0x487 0x951f 0x8f5b 0x4be 0x96be 0x8ef9 0x4cc 0x985d 0x8d83 0x481 0x99fc 0x8b71 0x496 0x9b9b 0x88a9 0x4e3 0x9d3a 0x8481 0x5be 0x9ed9 0x800c 0x6f4 0xa078 0x800c 0x6f4>;
		battery2_profile_t1_num = <0x64>;
		battery2_profile_t1 = <0x0 0xab22 0x55a 0x19f 0xaa7c 0x55a 0x33e 0xa9ea 0x553 0x4dd 0xa962 0x54b 0x67c 0xa8e0 0x546 0x81b 0xa863 0x545 0x9ba 0xa7e0 0x53c 0xb59 0xa764 0x53c 0xcf8 0xa6e7 0x53c 0xe97 0xa66f 0x538 0x1035 0xa5f8 0x535 0x11d4 0xa57d 0x53b 0x1373 0xa509 0x533 0x1512 0xa494 0x53a 0x16b1 0xa420 0x53c 0x1850 0xa3ac 0x540 0x19ef 0xa338 0x546 0x1b8e 0xa2c5 0x547 0x1d2d 0xa25b 0x54f 0x1ecc 0xa1e8 0x557 0x206b 0xa174 0x55a 0x220a 0xa104 0x55e 0x23a9 0xa098 0x568 0x2548 0xa02c 0x578 0x26e7 0x9fc0 0x56f 0x2886 0x9f5b 0x57c 0x2a25 0x9f12 0x5a8 0x2bc4 0x9eca 0x5cc 0x2d63 0x9e62 0x5ca 0x2f02 0x9dd5 0x5aa 0x30a0 0x9d32 0x5a2 0x323f 0x9ca7 0x5a7 0x33de 0x9c3b 0x5b4 0x357d 0x9bed 0x5cb 0x371c 0x9bb3 0x5ee 0x38bb 0x9b79 0x617 0x3a5a 0x9b3f 0x620 0x3bf9 0x9af8 0x62f 0x3d98 0x9aa8 0x640 0x3f37 0x9a55 0x653 0x40d6 0x9a02 0x668 0x4275 0x99af 0x668 0x4414 0x9947 0x651 0x45b3 0x98d5 0x61a 0x4752 0x985d 0x5ce 0x48f1 0x97e3 0x57b 0x4a90 0x9772 0x52e 0x4c2f 0x971f 0x50d 0x4dce 0x96d4 0x502 0x4f6d 0x9695 0x4f4 0x510b 0x965b 0x4ec 0x52aa 0x9623 0x4ec 0x5449 0x95f2 0x4ec 0x55e8 0x95c0 0x4ec 0x5787 0x958f 0x4ec 0x5926 0x9563 0x4ec 0x5ac5 0x9539 0x4ec 0x5c64 0x9512 0x4f0 0x5e03 0x94f1 0x500 0x5fa2 0x94cf 0x500 0x6141 0x94a7 0x500 0x62e0 0x9483 0x500 0x647f 0x9465 0x504 0x661e 0x944b 0x50c 0x67bd 0x942a 0x514 0x695c 0x9411 0x51c 0x6afb 0x93ff 0x525 0x6c9a 0x93e5 0x528 0x6e39 0x93c7 0x52b 0x6fd8 0x93af 0x532 0x7176 0x939f 0x532 0x7315 0x937e 0x522 0x74b4 0x935d 0x511 0x7653 0x933b 0x4f7 0x77f2 0x931a 0x4df 0x7991 0x92f8 0x4d8 0x7b30 0x92ce 0x4d8 0x7ccf 0x92ad 0x4e0 0x7e6e 0x9286 0x4dc 0x800d 0x9261 0x4e0 0x81ac 0x9240 0x4ec 0x834b 0x921c 0x4ec 0x84ea 0x91e2 0x4ec 0x8689 0x91a8 0x4ec 0x8828 0x916e 0x4f7 0x89c7 0x9134 0x508 0x8b66 0x90f1 0x512 0x8d05 0x9098 0x509 0x8ea4 0x905e 0x4f8 0x9043 0x9048 0x504 0x91e1 0x903d 0x520 0x9380 0x9031 0x540 0x951f 0x901e 0x569 0x96be 0x9004 0x5ab 0x985d 0x8fa0 0x5e6 0x99fc 0x8e4e 0x5e2 0x9b9b 0x8c53 0x60f 0x9d3a 0x8997 0x68e 0x9ed9 0x8584 0x7e3 0xa078 0x7ed6 0xb7c>;
		battery2_profile_t2_num = <0x64>;
		battery2_profile_t2 = <0x0 0xab22 0x55a 0x19f 0xaa7c 0x55a 0x33e 0xa9ea 0x553 0x4dd 0xa962 0x54b 0x67c 0xa8e0 0x546 0x81b 0xa863 0x545 0x9ba 0xa7e0 0x53c 0xb59 0xa764 0x53c 0xcf8 0xa6e7 0x53c 0xe97 0xa66f 0x538 0x1035 0xa5f8 0x535 0x11d4 0xa57d 0x53b 0x1373 0xa509 0x533 0x1512 0xa494 0x53a 0x16b1 0xa420 0x53c 0x1850 0xa3ac 0x540 0x19ef 0xa338 0x546 0x1b8e 0xa2c5 0x547 0x1d2d 0xa25b 0x54f 0x1ecc 0xa1e8 0x557 0x206b 0xa174 0x55a 0x220a 0xa104 0x55e 0x23a9 0xa098 0x568 0x2548 0xa02c 0x578 0x26e7 0x9fc0 0x56f 0x2886 0x9f5b 0x57c 0x2a25 0x9f12 0x5a8 0x2bc4 0x9eca 0x5cc 0x2d63 0x9e62 0x5ca 0x2f02 0x9dd5 0x5aa 0x30a0 0x9d32 0x5a2 0x323f 0x9ca7 0x5a7 0x33de 0x9c3b 0x5b4 0x357d 0x9bed 0x5cb 0x371c 0x9bb3 0x5ee 0x38bb 0x9b79 0x617 0x3a5a 0x9b3f 0x620 0x3bf9 0x9af8 0x62f 0x3d98 0x9aa8 0x640 0x3f37 0x9a55 0x653 0x40d6 0x9a02 0x668 0x4275 0x99af 0x668 0x4414 0x9947 0x651 0x45b3 0x98d5 0x61a 0x4752 0x985d 0x5ce 0x48f1 0x97e3 0x57b 0x4a90 0x9772 0x52e 0x4c2f 0x971f 0x50d 0x4dce 0x96d4 0x502 0x4f6d 0x9695 0x4f4 0x510b 0x965b 0x4ec 0x52aa 0x9623 0x4ec 0x5449 0x95f2 0x4ec 0x55e8 0x95c0 0x4ec 0x5787 0x958f 0x4ec 0x5926 0x9563 0x4ec 0x5ac5 0x9539 0x4ec 0x5c64 0x9512 0x4f0 0x5e03 0x94f1 0x500 0x5fa2 0x94cf 0x500 0x6141 0x94a7 0x500 0x62e0 0x9483 0x500 0x647f 0x9465 0x504 0x661e 0x944b 0x50c 0x67bd 0x942a 0x514 0x695c 0x9411 0x51c 0x6afb 0x93ff 0x525 0x6c9a 0x93e5 0x528 0x6e39 0x93c7 0x52b 0x6fd8 0x93af 0x532 0x7176 0x939f 0x532 0x7315 0x937e 0x522 0x74b4 0x935d 0x511 0x7653 0x933b 0x4f7 0x77f2 0x931a 0x4df 0x7991 0x92f8 0x4d8 0x7b30 0x92ce 0x4d8 0x7ccf 0x92ad 0x4e0 0x7e6e 0x9286 0x4dc 0x800d 0x9261 0x4e0 0x81ac 0x9240 0x4ec 0x834b 0x921c 0x4ec 0x84ea 0x91e2 0x4ec 0x8689 0x91a8 0x4ec 0x8828 0x916e 0x4f7 0x89c7 0x9134 0x508 0x8b66 0x90f1 0x512 0x8d05 0x9098 0x509 0x8ea4 0x905e 0x4f8 0x9043 0x9048 0x504 0x91e1 0x903d 0x520 0x9380 0x9031 0x540 0x951f 0x901e 0x569 0x96be 0x9004 0x5ab 0x985d 0x8fa0 0x5e6 0x99fc 0x8e4e 0x5e2 0x9b9b 0x8c53 0x60f 0x9d3a 0x8997 0x68e 0x9ed9 0x8584 0x7e3 0xa078 0x7ed6 0xb7c>;
		battery2_profile_t3_num = <0x64>;
		battery2_profile_t3 = <0x0 0xab0e 0xf1e 0x19f 0xaa47 0xf1e 0x33e 0xa99a 0xf11 0x4dd 0xa8fe 0xeed 0x67c 0xa86f 0xec1 0x81b 0xa7eb 0xea0 0x9ba 0xa768 0xe80 0xb59 0xa6ec 0xe6e 0xcf8 0xa675 0xe51 0xe97 0xa5fd 0xe30 0x1035 0xa583 0xe14 0x11d4 0xa50f 0xe03 0x1373 0xa49b 0xdea 0x1512 0xa42e 0xdd9 0x16b1 0xa3bc 0xdce 0x1850 0xa34c 0xdc1 0x19ef 0xa2e0 0xdb9 0x1b8e 0xa275 0xdc1 0x1d2d 0xa20b 0xdc9 0x1ecc 0xa198 0xdc3 0x206b 0xa129 0xdc0 0x220a 0xa0be 0xdb8 0x23a9 0xa056 0xdae 0x2548 0x9ffc 0xdb8 0x26e7 0x9fb1 0xde2 0x2886 0x9f6d 0xe4b 0x2a25 0x9f16 0xe8f 0x2bc4 0x9e98 0xe90 0x2d63 0x9df5 0xe50 0x2f02 0x9d3f 0xde6 0x30a0 0x9c9c 0xd9c 0x323f 0x9c18 0xd6d 0x33de 0x9baa 0xd57 0x357d 0x9b4d 0xd4f 0x371c 0x9afd 0xd4b 0x38bb 0x9abb 0xd5c 0x3a5a 0x9a79 0xd54 0x3bf9 0x9a36 0xd52 0x3d98 0x99e6 0xd35 0x3f37 0x998a 0xd04 0x40d6 0x992e 0xcd0 0x4275 0x98ca 0xc96 0x4414 0x9868 0xc5d 0x45b3 0x9811 0xc2a 0x4752 0x97ba 0xbf8 0x48f1 0x9764 0xbd1 0x4a90 0x9719 0xbbf 0x4c2f 0x96cf 0xba6 0x4dce 0x9693 0xba4 0x4f6d 0x9653 0xb9e 0x510b 0x9619 0xb9a 0x52aa 0x95e7 0xb9c 0x5449 0x95b6 0xba4 0x55e8 0x9584 0xba4 0x5787 0x955a 0xba4 0x5926 0x9531 0xbb4 0x5ac5 0x9507 0xbc6 0x5c64 0x94e0 0xbcc 0x5e03 0x94bf 0xbcd 0x5fa2 0x949d 0xbe6 0x6141 0x947c 0xbf1 0x62e0 0x9460 0xbfe 0x647f 0x9444 0xc0f 0x661e 0x9424 0xc1c 0x67bd 0x940c 0xc1c 0x695c 0x93fb 0xc2d 0x6afb 0x93eb 0xc44 0x6c9a 0x93da 0xc58 0x6e39 0x93cd 0xc68 0x6fd8 0x93c5 0xc7c 0x7176 0x93bc 0xc9d 0x7315 0x93ac 0xcb6 0x74b4 0x93a2 0xce8 0x7653 0x9390 0xd10 0x77f2 0x9377 0xd2c 0x7991 0x935e 0xd51 0x7b30 0x9345 0xd8b 0x7ccf 0x9325 0xdbd 0x7e6e 0x92fe 0xdf4 0x800d 0x92d5 0xe3e 0x81ac 0x92a9 0xe9a 0x834b 0x9276 0xef8 0x84ea 0x923c 0xf75 0x8689 0x91f3 0xff1 0x8828 0x91b4 0x108a 0x89c7 0x916e 0x1138 0x8b66 0x911d 0x11f6 0x8d05 0x90d4 0x12cb 0x8ea4 0x90a3 0x13e5 0x9043 0x9078 0x1539 0x91e1 0x905a 0x16e2 0x9380 0x903a 0x18e5 0x951f 0x9009 0x1b53 0x96be 0x8fbc 0x1e52 0x985d 0x8f0d 0x21d3 0x99fc 0x8da1 0x259e 0x9b9b 0x8b7b 0x2b3a 0x9d3a 0x887e 0x333a 0x9ed9 0x858e 0x3b10 0xa078 0x858e 0x3b10>;
		battery2_profile_t4_num = <0x64>;
		battery2_profile_t4 = <0x0 0xab04 0x2238 0x19f 0xaa1c 0x2238 0x33e 0xa954 0x223f 0x4dd 0xa8a4 0x220c 0x67c 0xa804 0x21b4 0x81b 0xa773 0x2160 0x9ba 0xa6f0 0x2106 0xb59 0xa66c 0x20bb 0xcf8 0xa5e7 0x206a 0xe97 0xa562 0x2013 0x1035 0xa4e0 0x1fba 0x11d4 0xa465 0x1f69 0x1373 0xa3f1 0x1f27 0x1512 0xa37c 0x1ee5 0x16b1 0xa30e 0x1eae 0x1850 0xa29e 0x1e78 0x19ef 0xa22a 0x1e3b 0x1b8e 0xa1b7 0x1dfc 0x1d2d 0xa14d 0x1dd3 0x1ecc 0xa0da 0x1d94 0x206b 0xa077 0x1d68 0x220a 0xa023 0x1d66 0x23a9 0x9fd4 0x1d82 0x2548 0x9f78 0x1d92 0x26e7 0x9f0c 0x1d89 0x2886 0x9e76 0x1d1e 0x2a25 0x9dc8 0x1c81 0x2bc4 0x9d15 0x1bde 0x2d63 0x9c6e 0x1b56 0x2f02 0x9be3 0x1afc 0x30a0 0x9b79 0x1ac3 0x323f 0x9b0d 0x1a97 0x33de 0x9ab0 0x1a81 0x357d 0x9a64 0x1a75 0x371c 0x9a20 0x1a65 0x38bb 0x99d5 0x1a54 0x3a5a 0x998b 0x1a54 0x3bf9 0x9939 0x1a3a 0x3d98 0x98e6 0x1a19 0x3f37 0x9893 0x19f8 0x40d6 0x9840 0x19d8 0x4275 0x97ed 0x19bf 0x4414 0x97a4 0x199f 0x45b3 0x9759 0x197e 0x4752 0x9713 0x195d 0x48f1 0x96d1 0x1943 0x4a90 0x968f 0x193b 0x4c2f 0x9655 0x1933 0x4dce 0x961b 0x1923 0x4f6d 0x95e7 0x1918 0x510b 0x95b1 0x190c 0x52aa 0x957c 0x1905 0x5449 0x9552 0x1915 0x55e8 0x9529 0x191d 0x5787 0x9500 0x192c 0x5926 0x94d7 0x193d 0x5ac5 0x94b1 0x1955 0x5c64 0x9490 0x1976 0x5e03 0x946f 0x1998 0x5fa2 0x9456 0x19c1 0x6141 0x9444 0x19e4 0x62e0 0x942e 0x1a0f 0x647f 0x941c 0x1a48 0x661e 0x9412 0x1a8d 0x67bd 0x9402 0x1ad7 0x695c 0x93fa 0x1b2a 0x6afb 0x93eb 0x1b7c 0x6c9a 0x93da 0x1bd8 0x6e39 0x93cd 0x1c3c 0x6fd8 0x93c3 0x1ca6 0x7176 0x93b3 0x1d33 0x7315 0x93a2 0x1dc0 0x74b4 0x9391 0x1e5a 0x7653 0x937c 0x1f06 0x77f2 0x9363 0x1fc5 0x7991 0x9349 0x2098 0x7b30 0x9328 0x2181 0x7ccf 0x9307 0x2271 0x7e6e 0x92e0 0x237c 0x800d 0x92b7 0x24a9 0x81ac 0x928b 0x25f9 0x834b 0x9258 0x276b 0x84ea 0x921e 0x290a 0x8689 0x91dd 0x2add 0x8828 0x919a 0x2ce3 0x89c7 0x9158 0x2f0f 0x8b66 0x9115 0x3163 0x8d05 0x90d4 0x33f1 0x8ea4 0x909a 0x3667 0x9043 0x906e 0x3879 0x91e1 0x9045 0x3a7a 0x9380 0x901c 0x3c6d 0x951f 0x8feb 0x3e4b 0x96be 0x8f9d 0x401c 0x985d 0x8ede 0x41fd 0x99fc 0x8d68 0x444b 0x9b9b 0x8b30 0x4835 0x9d3a 0x87f1 0x4eef 0x9ed9 0x849e 0x5668 0xa078 0x849e 0x5668>;
		linux,phandle = <0x76>;
		phandle = <0x76>;
	};

	topmisc@10011000 {
		compatible = "mediatek,topmisc";
		reg = <0x0 0x10011000 0x0 0x1000>;
	};

	dvfsrc@10012000 {
		compatible = "mediatek,dvfsrc";
		reg = <0x0 0x10012000 0x0 0x1000 0x0 0x110780 0x0 0x80>;
	};

	mbist_ao@10013000 {
		compatible = "mediatek,mbist_ao";
		reg = <0x0 0x10013000 0x0 0x1000>;
	};

	apcldmain_ao@10014000 {
		compatible = "mediatek,apcldmain_ao";
		reg = <0x0 0x10014000 0x0 0x400>;
	};

	apcldmaout_ao@10014400 {
		compatible = "mediatek,apcldmaout_ao";
		reg = <0x0 0x10014400 0x0 0x400>;
	};

	apcldmamisc_ao@10014800 {
		compatible = "mediatek,apcldmamisc_ao";
		reg = <0x0 0x10014800 0x0 0x400>;
	};

	apcldmamisc_ao@10014c00 {
		compatible = "mediatek,apcldmamisc_ao";
		reg = <0x0 0x10014c00 0x0 0x400>;
	};

	aes_top0@10016000 {
		compatible = "mediatek,aes_top0";
		reg = <0x0 0x10016000 0x0 0x1000>;
	};

	sys_timer@10017000 {
		compatible = "mediatek,sys_timer";
		reg = <0x0 0x10017000 0x0 0x1000>;
		reg-names = "sys_timer_base";
		interrupts = <0x0 0x8a 0x4>;
	};

	modem_temp_share@10018000 {
		compatible = "mediatek,modem_temp_share";
		reg = <0x0 0x10018000 0x0 0x1000>;
	};

	security_ao@1001a000 {
		compatible = "mediatek,security_ao";
		reg = <0x0 0x1001a000 0x0 0x1000>;
	};

	topckgen_ao@1001b000 {
		compatible = "mediatek,topckgen_ao";
		reg = <0x0 0x1001b000 0x0 0x1000>;
	};

	iocfg_0@10002000 {
		compatible = "mediatek,iocfg_0";
		reg = <0x0 0x10002000 0x0 0x200>;
	};

	iocfg_1@10002200 {
		compatible = "mediatek,iocfg_1";
		reg = <0x0 0x10002200 0x0 0x200>;
	};

	iocfg_2@10002400 {
		compatible = "mediatek,iocfg_2";
		reg = <0x0 0x10002400 0x0 0x200>;
	};

	iocfg_3@10002600 {
		compatible = "mediatek,iocfg_3";
		reg = <0x0 0x10002600 0x0 0x200>;
	};

	iocfg_4@10002800 {
		compatible = "mediatek,iocfg_4";
		reg = <0x0 0x10002800 0x0 0x200>;
	};

	iocfg_5@10002a00 {
		compatible = "mediatek,iocfg_5";
		reg = <0x0 0x10002a00 0x0 0x200>;
	};

	mdcldmain_ao@10015000 {
		compatible = "mediatek,mdcldmain_ao";
		reg = <0x0 0x10015000 0x0 0x400>;
	};

	mdcldmaout_ao@10015400 {
		compatible = "mediatek,mdcldmaout_ao";
		reg = <0x0 0x10015400 0x0 0x400>;
	};

	mdcldmamisc_ao@10015800 {
		compatible = "mediatek,mdcldmamisc_ao";
		reg = <0x0 0x10015800 0x0 0x400>;
	};

	sys_cirq@10204000 {
		compatible = "mediatek,sys_cirq";
		reg = <0x0 0x10204000 0x0 0x1000>;
		mediatek,cirq_num = <0xd1>;
		mediatek,spi_start_offset = <0x10>;
		interrupts = <0x0 0xe0 0x8>;
	};

	mcucfg@10200000 {
		compatible = "mediatek,mcucfg";
		reg = <0x0 0x10200000 0x0 0x200>;
		interrupts = <0x0 0x0 0x4>;
	};

	mcucfg@10200200 {
		compatible = "mediatek,mcucfg";
		reg = <0x0 0x10200200 0x0 0x200>;
		interrupts = <0x0 0x1 0x8>;
	};

	mcucfg@10200400 {
		compatible = "mediatek,mcucfg";
		reg = <0x0 0x10200400 0x0 0x200>;
		interrupts = <0x0 0x2 0x4>;
	};

	mcucfg@10200600 {
		compatible = "mediatek,mcucfg";
		reg = <0x0 0x10200600 0x0 0x200>;
		interrupts = <0x0 0x3 0x4>;
	};

	mcucfg@10200800 {
		compatible = "mediatek,mcucfg";
		reg = <0x0 0x10200800 0x0 0x200>;
		interrupts = <0x0 0x4 0x4>;
	};

	mcucfg@10200a00 {
		compatible = "mediatek,mcucfg";
		reg = <0x0 0x10200a00 0x0 0x300>;
		interrupts = <0x0 0x5 0x8>;
	};

	mcucfg@10200f00 {
		compatible = "mediatek,mcucfg";
		reg = <0x0 0x10200f00 0x0 0x100>;
		interrupts = <0x0 0x6 0x8>;
	};

	mcucfg@10201000 {
		compatible = "mediatek,mcucfg";
		reg = <0x0 0x10201000 0x0 0x1000>;
		interrupts = <0x0 0x7 0x8>;
	};

	mcucfg@10202000 {
		compatible = "mediatek,mcucfg";
		reg = <0x0 0x10202000 0x0 0x1000>;
		interrupts = <0x0 0x8 0x8>;
	};

	mcucfg@10203000 {
		compatible = "mediatek,mcucfg";
		reg = <0x0 0x10203000 0x0 0x1000>;
		interrupts = <0x0 0x9 0x8>;
	};

	mcucfg_mp0_counter@10200000 {
		compatible = "mediatek,mcucfg_mp0_counter";
		reg = <0x0 0x10200000 0x0 0x4000>;
	};

	m4u@10205000 {
		cell-index = <0x0>;
		compatible = "mediatek,iommu_v0";
		reg = <0x0 0x10205000 0x0 0x1000>;
		mediatek,larbs = <0x1d 0x1e 0x1f>;
		interrupts = <0x0 0x9e 0x8>;
		#iommu-cells = <0x1>;
		linux,phandle = <0x44>;
		phandle = <0x44>;
	};

	devapc@10207000 {
		compatible = "mediatek,devapc";
		reg = <0x0 0x10207000 0x0 0x1000>;
		interrupts = <0x0 0x56 0x8>;
		clocks = <0x20 0x28>;
		clock-names = "devapc-infra-clock";
	};

	bus_dbg@10208000 {
		compatible = "mediatek,bus_dbg-v2";
		reg = <0x0 0x10208000 0x0 0x1000 0x0 0x10001000 0x0 0x1000>;
		mediatek,bus_dbg_con_offset = <0x2fc>;
		interrupts = <0x0 0x55 0x8>;
	};

	ap_ccif0@10209000 {
		compatible = "mediatek,ap_ccif0";
		reg = <0x0 0x10209000 0x0 0x1000>;
		interrupts = <0x0 0x5c 0x8>;
	};

	md_ccif0@1020a000 {
		compatible = "mediatek,md_ccif0";
		reg = <0x0 0x1020a000 0x0 0x1000>;
	};

	ap_ccif1@1020b000 {
		compatible = "mediatek,ap_ccif1";
		reg = <0x0 0x1020b000 0x0 0x1000>;
		interrupts = <0x0 0x5e 0x8>;
	};

	md_ccif1@1020c000 {
		compatible = "mediatek,md_ccif1";
		reg = <0x0 0x1020c000 0x0 0x1000>;
	};

	infra_mbist@1020d000 {
		compatible = "mediatek,infra_mbist";
		reg = <0x0 0x1020d000 0x0 0x1000>;
	};

	infracfg@1020e000 {
		compatible = "mediatek,infracfg";
		reg = <0x0 0x1020e000 0x0 0x1000>;
	};

	trng@1020f000 {
		compatible = "mediatek,trng";
		reg = <0x0 0x1020f000 0x0 0x1000>;
		interrupts = <0x0 0x69 0x8>;
	};

	dxcc_sec@10210000 {
		compatible = "mediatek,dxcc_sec";
		reg = <0x0 0x10210000 0x0 0x1000>;
		interrupts = <0x0 0x6a 0x4>;
	};

	mcupm_sram2@10211000 {
		compatible = "mediatek,mcupm_sram2";
		reg = <0x0 0x10211000 0x0 0x1000>;
	};

	cq_dma@10212000 {
		compatible = "mediatek,mt-cqdma-v1";
		reg = <0x0 0x10212000 0x0 0x80 0x0 0x10212080 0x0 0x80 0x0 0x10212100 0x0 0x68>;
		interrupts = <0x0 0x39 0x8 0x0 0x3a 0x8 0x0 0x3b 0x8>;
		nr_channel = <0x3>;
		keep_clock_ao = "yes";
		clocks = <0x20 0x43>;
		clock-names = "cqdma";
	};

	mcupm_sram3@10213000 {
		compatible = "mediatek,mcupm_sram3";
		reg = <0x0 0x10213000 0x0 0x1000>;
	};

	sramrom@10214000 {
		compatible = "mediatek,sramrom";
		reg = <0x0 0x10214000 0x0 0x1000>;
	};

	mcupm_reg@10216000 {
		compatible = "mediatek,mcupm_reg";
		reg = <0x0 0x10216000 0x0 0x1000>;
	};

	mcupm_sram0@10217000 {
		compatible = "mediatek,mcupm_sram0";
		reg = <0x0 0x10217000 0x0 0x1000>;
	};

	mcupm_sram1@10218000 {
		compatible = "mediatek,mcupm_sram1";
		reg = <0x0 0x10218000 0x0 0x1000>;
	};

	emi@10219000 {
		compatible = "mediatek,emi";
		reg = <0x0 0x10219000 0x0 0x1000 0x0 0x10226000 0x0 0x1000 0x0 0x1022d000 0x0 0x1000 0x0 0x10235000 0x0 0x1000>;
		interrupts = <0x0 0x58 0x8>;
	};

	apcldmain@1021b000 {
		compatible = "mediatek,apcldmain";
		reg = <0x0 0x1021b000 0x0 0x100>;
	};

	apcldmaout@1021b400 {
		compatible = "mediatek,apcldmaout";
		reg = <0x0 0x1021b400 0x0 0x100>;
	};

	apcldmamisc@1021b800 {
		compatible = "mediatek,apcldmamisc";
		reg = <0x0 0x1021b800 0x0 0x100>;
		interrupts = <0x0 0x6d 0x4>;
	};

	mdcldmain@1021c000 {
		compatible = "mediatek,mdcldmain";
		reg = <0x0 0x1021c000 0x0 0x400>;
	};

	mdcldmaout@1021c400 {
		compatible = "mediatek,mdcldmaout";
		reg = <0x0 0x1021c400 0x0 0x400>;
	};

	mdcldmamisc@1021c800 {
		compatible = "mediatek,mdcldmamisc";
		reg = <0x0 0x1021c800 0x0 0x1000>;
	};

	mdcldma@10014000 {
		compatible = "mediatek,mdcldma";
		reg = <0x0 0x10014000 0x0 0x1000 0x0 0x1021b000 0x0 0x1000 0x0 0x10209000 0x0 0x1000 0x0 0x1020a000 0x0 0x1000>;
		interrupts = <0x0 0x6d 0x4 0x0 0x5c 0x8 0x0 0x5d 0x8 0x0 0xcd 0x2>;
		mediatek,md_id = <0x0>;
		mediatek,cldma_capability = <0x6>;
		clocks = <0x21 0x0 0x20 0x32 0x20 0x29 0x20 0x2c 0x20 0x23 0x20 0x24 0x20 0x58 0x20 0x59>;
		clock-names = "scp-sys-md1-main", "infra-cldma-bclk", "infra-ccif-ap", "infra-ccif-md", "infra-ccif1-ap", "infra-ccif1-md", "infra-ccif2-ap", "infra-ccif2-md";
		linux,phandle = <0x10>;
		phandle = <0x10>;
	};

	bpi_bsi_slv0@1021e000 {
		compatible = "mediatek,bpi_bsi_slv0";
		reg = <0x0 0x1021e000 0x0 0x1000>;
	};

	bpi_bsi_slv1@1021f000 {
		compatible = "mediatek,bpi_bsi_slv1";
		reg = <0x0 0x1021f000 0x0 0x6000>;
	};

	bpi_bsi_slv2@10225000 {
		compatible = "mediatek,bpi_bsi_slv2";
		reg = <0x0 0x10225000 0x0 0x1000>;
	};

	dvfsp@10227000 {
		compatible = "mediatek,dvfsp";
		reg = <0x0 0x10227000 0x0 0x1000>;
	};

	dvfsp@00110800 {
		compatible = "mediatek,mt6761-dvfsp";
		reg = <0x0 0x110800 0x0 0x1400 0x0 0x110800 0x0 0x1400>;
	};

	dramc@1022a000 {
		compatible = "mediatek,dramc";
		reg = <0x0 0x1022a000 0x0 0x2000 0x0 0x10232000 0x0 0x2000 0x0 0x1022c000 0x0 0x1000 0x0 0x10234000 0x0 0x1000 0x0 0x10228000 0x0 0x2000 0x0 0x10230000 0x0 0x2000 0x0 0x1022e000 0x0 0x1000 0x0 0x10236000 0x0 0x1000>;
	};

	gce@10238000 {
		compatible = "mediatek,gce", "syscon";
		reg = <0x0 0x10238000 0x0 0x4000>;
		#clock-cells = <0x1>;
		interrupts = <0x0 0x62 0x8>;
		g3d_config_base = <0x13000000 0x0 0xffff0000>;
		mmsys_config_base = <0x14000000 0x1 0xffff0000>;
		disp_dither_base = <0x14010000 0x2 0xffff0000>;
		mm_na_base = <0x14020000 0x3 0xffff0000>;
		imgsys_base = <0x15020000 0x4 0xffff0000>;
		vdec_gcon_base = <0x18800000 0x5 0xffff0000>;
		venc_gcon_base = <0x18810000 0x6 0xffff0000>;
		conn_peri_base = <0x18820000 0x7 0xffff0000>;
		topckgen_base = <0x18830000 0x8 0xffff0000>;
		kp_base = <0x18840000 0x9 0xffff0000>;
		scp_sram_base = <0x10000000 0xa 0xffff0000>;
		infra_na3_base = <0x10010000 0xb 0xffff0000>;
		infra_na4_base = <0x10020000 0xc 0xffff0000>;
		scp_base = <0x10030000 0xd 0xffff0000>;
		mcucfg_base = <0x10040000 0xe 0xffff0000>;
		gcpu_base = <0x10050000 0xf 0xffff0000>;
		usb0_base = <0x10200000 0x10 0xffff0000>;
		usb_sif_base = <0x10280000 0x11 0xffff0000>;
		audio_base = <0x17000000 0x12 0xffff0000>;
		vdec_base = <0x17010000 0x13 0xffff0000>;
		msdc2_base = <0x17020000 0x14 0xffff0000>;
		vdec1_base = <0x17030000 0x15 0xffff0000>;
		msdc3_base = <0x18000000 0x16 0xffff0000>;
		ap_dma_base = <0x18010000 0x17 0xffff0000>;
		gce_base = <0x18020000 0x18 0xffff0000>;
		vdec2_base = <0x18040000 0x19 0xffff0000>;
		vdec3_base = <0x18050000 0x1a 0xffff0000>;
		camsys_base = <0x18080000 0x1b 0xffff0000>;
		camsys1_base = <0x180a0000 0x1c 0xffff0000>;
		camsys2_base = <0x180b0000 0x1d 0xffff0000>;
		pwm_sw_base = <0x1100e000 0x63 0xffff0000>;
		mipitx0_base = <0x11c80000 0x63 0xffff0000>;
		mdp_rdma0_sof = <0x0>;
		mdp_ccorr0_sof = <0x1>;
		mdp_rsz0_sof = <0x2>;
		mdp_rsz1_sof = <0x3>;
		mdp_wdma_sof = <0x4>;
		mdp_wrot0_sof = <0x5>;
		mdp_tdshp0_sof = <0x6>;
		disp_ovl0_sof = <0x7>;
		disp_2l_ovl0_sof = <0x8>;
		disp_rdma0_sof = <0x9>;
		disp_wdma0_sof = <0xa>;
		disp_color0_sof = <0xb>;
		disp_ccorr0_sof = <0xc>;
		disp_aal0_sof = <0xd>;
		disp_gamma0_sof = <0xe>;
		disp_dither0_sof = <0xf>;
		disp_dsi0_sof = <0x10>;
		disp_rsz0_sof = <0x11>;
		img_dl_relay_sof = <0x12>;
		disp_pwm0_sof = <0x13>;
		mdp_rdma0_frame_done = <0x14>;
		mdp_ccorr0_frame_done = <0x15>;
		mdp_rsz0_frame_done = <0x16>;
		mdp_rsz1_frame_done = <0x17>;
		mdp_wrot0_write_frame_done = <0x18>;
		mdp_wdma_frame_done = <0x19>;
		mdp_tdshp0_frame_done = <0x1a>;
		disp_ovl0_frame_done = <0x1b>;
		disp_2l_ovl0_frame_done = <0x1c>;
		disp_rsz0_frame_done = <0x1d>;
		disp_rdma0_frame_done = <0x1e>;
		disp_wdma0_frame_done = <0x1f>;
		disp_color0_frame_done = <0x20>;
		disp_ccorr0_frame_done = <0x21>;
		disp_aal0_frame_done = <0x22>;
		disp_gamma0_frame_done = <0x23>;
		disp_dither0_frame_done = <0x24>;
		disp_dsi0_frame_done = <0x25>;
		stream_done_0 = <0x82>;
		stream_done_1 = <0x83>;
		stream_done_2 = <0x84>;
		stream_done_3 = <0x85>;
		stream_done_4 = <0x86>;
		stream_done_5 = <0x87>;
		stream_done_6 = <0x88>;
		stream_done_7 = <0x89>;
		stream_done_8 = <0x8a>;
		stream_done_9 = <0x8b>;
		buf_underrun_event_0 = <0x8c>;
		dsi0_te_event = <0x8d>;
		dsi0_irq_event = <0x8e>;
		dsi0_done_event = <0x8f>;
		disp_wdma0_rst_done = <0x93>;
		mdp_wdma_rst_done = <0x94>;
		mdp_wrot0_rst_done = <0x95>;
		mdp_rdma0_rst_done = <0x97>;
		disp_ovl0_frame_rst_done_pusle = <0x98>;
		dip_cq_thread2_frame_done = <0x101>;
		dip_cq_thread1_frame_done = <0x102>;
		dip_cq_thread0_frame_done = <0x103>;
		isp_frame_done_p1_1 = <0x104>;
		isp_frame_done_p1_0 = <0x105>;
		camsv_0_pass1_done = <0x106>;
		camsv_1_pass1_done = <0x107>;
		seninf_0_fifo_full = <0x108>;
		seninf_1_fifo_full = <0x109>;
		seninf_2_fifo_full = <0x10a>;
		seninf_3_fifo_full = <0x10b>;
		seninf_4_fifo_full = <0x10c>;
		seninf_5_fifo_full = <0x10d>;
		seninf_6_fifo_full = <0x10e>;
		seninf_7_fifo_full = <0x10f>;
		venc_done = <0x121>;
		jpgenc_done = <0x122>;
		jpgdec_done = <0x123>;
		venc_mb_done = <0x124>;
		venc_128byte_cnt_done = <0x125>;
		max_prefetch_cnt = <0x1>;
		prefetch_size = <0x60>;
		sram_size_cpr_64 = <0x40>;
		mmsys_config = <0x22>;
		mdp_rdma0 = <0x23>;
		mdp_rsz0 = <0x24>;
		mdp_rsz1 = <0x25>;
		mdp_wdma0 = <0x26>;
		mdp_wrot0 = <0x27>;
		mdp_tdshp0 = <0x28>;
		mdp_color0 = <0x29>;
		mdp_ccorr0 = <0x2a>;
		mm_mutex = <0x2b>;
		sram_share_cnt = <0x1>;
		sram_share_engine = <0xa>;
		sram_share_event = <0x2c6>;
		clocks = <0x20 0x9 0x20 0x18>;
		clock-names = "GCE", "GCE_TIMER";
		mediatek,mailbox-gce = <0x2c>;
		mboxes = <0x2c 0x0 0x0 0x4 0x2c 0x1 0x0 0x4 0x2c 0x2 0x0 0x5 0x2c 0x3 0x0 0x4 0x2c 0x4 0x0 0x4 0x2c 0x5 0x0 0x4 0x2c 0x6 0xc8 0x4 0x2c 0x7 0xffffffff 0x2 0x2c 0x8 0x0 0x1 0x2c 0x9 0x0 0x1 0x2c 0xa 0x0 0x1 0x2c 0xb 0x0 0x1 0x2c 0xc 0x0 0x1 0x2c 0xd 0x0 0x1 0x2c 0xe 0x0 0x1 0x2c 0xf 0x0 0x1>;
		linux,phandle = <0x77>;
		phandle = <0x77>;
	};

	gce_mbox@10238000 {
		compatible = "mediatek,mailbox-gce";
		reg = <0x0 0x10238000 0x0 0x4000>;
		interrupts = <0x0 0x62 0x8>;
		#mbox-cells = <0x3>;
		#gce-event-cells = <0x1>;
		#gce-subsys-cells = <0x2>;
		clocks = <0x20 0x9 0x20 0x18>;
		clock-names = "gce", "GCE_TIMER";
		linux,phandle = <0x2c>;
		phandle = <0x2c>;
	};

	ap_ccif2@1023c000 {
		compatible = "mediatek,ap_ccif2";
		reg = <0x0 0x1023c000 0x0 0x1000>;
		interrupts = <0x0 0x57 0x8>;
	};

	md_ccif2@1023d000 {
		compatible = "mediatek,md_ccif2";
		reg = <0x0 0x1023d000 0x0 0x1000>;
	};

	ap_ccif3@1023e000 {
		compatible = "mediatek,ap_ccif3";
		reg = <0x0 0x1023e000 0x0 0x1000>;
		interrupts = <0x0 0x5a 0x8>;
	};

	md_ccif3@1023f000 {
		compatible = "mediatek,md_ccif3";
		reg = <0x0 0x1023f000 0x0 0x1000>;
	};

	sspm@10440000 {
		compatible = "mediatek,sspm";
		reg = <0x0 0x10440000 0x0 0x10000 0x0 0x10450000 0x0 0x100 0x0 0x10451000 0x0 0x8 0x0 0x10460000 0x0 0x100 0x0 0x10461000 0x0 0x8 0x0 0x10470000 0x0 0x100 0x0 0x10471000 0x0 0x8 0x0 0x10480000 0x0 0x100 0x0 0x10481000 0x0 0x8 0x0 0x10490000 0x0 0x100 0x0 0x10491000 0x0 0x8>;
		reg-names = "cfgreg", "mbox0_base", "mbox0_ctrl", "mbox1_base", "mbox1_ctrl", "mbox2_base", "mbox2_ctrl", "mbox3_base", "mbox3_ctrl", "mbox4_base", "mbox4_ctrl";
		interrupts = <0x0 0x92 0x4 0x0 0x95 0x4 0x0 0x96 0x4 0x0 0x97 0x4 0x0 0x98 0x4 0x0 0x99 0x4>;
		interrupt-names = "ipc", "mbox0", "mbox1", "mbox2", "mbox3", "mbox4";
	};

	gic500@0c000000 {
		compatible = "mediatek,gic500";
		reg = <0x0 0xc000000 0x0 0x400000>;
	};

	gic_cpu@0c400000 {
		compatible = "mediatek,gic_cpu";
		reg = <0x0 0xc400000 0x0 0x40000>;
	};

	dfd@10200b00 {
		compatible = "mediatek,dfd";
		reg = <0x0 0x10200b00 0x0 0x10000>;
		mediatek,enabled = <0x1>;
		mediatek,chain_length = <0x61a8>;
		mediatek,rg_dfd_timeout = <0xa0>;
	};

	dbg_cti@0d020000 {
		compatible = "mediatek,dbg_cti";
		reg = <0x0 0xd020000 0x0 0x10000>;
	};

	dbg_etr@0d030000 {
		compatible = "mediatek,dbg_etr";
		reg = <0x0 0xd030000 0x0 0x10000>;
	};

	dbg_funnel@0d040000 {
		compatible = "mediatek,dbg_funnel";
		reg = <0x0 0xd040000 0x0 0x10000>;
	};

	dbg_dem@0d0a0000 {
		compatible = "mediatek,dbg_dem";
		reg = <0x0 0xd0a0000 0x0 0x10000>;
		interrupts = <0x0 0x54 0x8>;
	};

	dbg_mdsys1@0d0c0000 {
		compatible = "mediatek,dbg_mdsys1";
		reg = <0x0 0xd0c0000 0x0 0x40000>;
	};

	dbg_apmcu_mp0@0d400000 {
		compatible = "mediatek,dbg_apmcu_mp0";
		reg = <0x0 0xd400000 0x0 0x1000>;
	};

	dbg_apmcu_mp0@0d410000 {
		compatible = "mediatek,dbg_apmcu_mp0";
		reg = <0x0 0xd410000 0x0 0x1000>;
	};

	dbg_apmcu_mp0@0d420000 {
		compatible = "mediatek,dbg_apmcu_mp0";
		reg = <0x0 0xd420000 0x0 0x1000>;
	};

	dbg_apmcu_mp0@0d430000 {
		compatible = "mediatek,dbg_apmcu_mp0";
		reg = <0x0 0xd430000 0x0 0x1000>;
	};

	dbg_apmcu_mp0@0d440000 {
		compatible = "mediatek,dbg_apmcu_mp0";
		reg = <0x0 0xd440000 0x0 0x1000>;
	};

	dbg_apmcu_mp0@0d510000 {
		compatible = "mediatek,dbg_apmcu_mp0";
		reg = <0x0 0xd510000 0x0 0x1000>;
	};

	dbg_apmcu_mp0@0d520000 {
		compatible = "mediatek,dbg_apmcu_mp0";
		reg = <0x0 0xd520000 0x0 0x1000>;
	};

	dbg_apmcu_mp0@0d530000 {
		compatible = "mediatek,dbg_apmcu_mp0";
		reg = <0x0 0xd530000 0x0 0x1000>;
	};

	dbg_apmcu_mp0@0d540000 {
		compatible = "mediatek,dbg_apmcu_mp0";
		reg = <0x0 0xd540000 0x0 0x1000>;
	};

	dbg_apmcu_mp0@0d610000 {
		compatible = "mediatek,dbg_apmcu_mp0";
		reg = <0x0 0xd610000 0x0 0x1000>;
	};

	dbg_apmcu_mp0@0d620000 {
		compatible = "mediatek,dbg_apmcu_mp0";
		reg = <0x0 0xd620000 0x0 0x1000>;
	};

	dbg_apmcu_mp0@0d630000 {
		compatible = "mediatek,dbg_apmcu_mp0";
		reg = <0x0 0xd630000 0x0 0x1000>;
	};

	dbg_apmcu_mp0@0d640000 {
		compatible = "mediatek,dbg_apmcu_mp0";
		reg = <0x0 0xd640000 0x0 0x1000>;
	};

	dbg_apmcu_mp0@0d710000 {
		compatible = "mediatek,dbg_apmcu_mp0";
		reg = <0x0 0xd710000 0x0 0x1000>;
	};

	dbg_apmcu_mp0@0d720000 {
		compatible = "mediatek,dbg_apmcu_mp0";
		reg = <0x0 0xd720000 0x0 0x1000>;
	};

	dbg_apmcu_mp0@0d730000 {
		compatible = "mediatek,dbg_apmcu_mp0";
		reg = <0x0 0xd730000 0x0 0x1000>;
	};

	dbg_apmcu_mp0@0d740000 {
		compatible = "mediatek,dbg_apmcu_mp0";
		reg = <0x0 0xd740000 0x0 0x1000>;
	};

	dbg_apmcu_mp1@0d800000 {
		compatible = "mediatek,dbg_apmcu_mp1";
		reg = <0x0 0xd800000 0x0 0x1000>;
	};

	dbg_apmcu_mp1@0d810000 {
		compatible = "mediatek,dbg_apmcu_mp1";
		reg = <0x0 0xd810000 0x0 0x1000>;
	};

	dbg_apmcu_mp1@0d820000 {
		compatible = "mediatek,dbg_apmcu_mp1";
		reg = <0x0 0xd820000 0x0 0x1000>;
	};

	dbg_apmcu_mp1@0d830000 {
		compatible = "mediatek,dbg_apmcu_mp1";
		reg = <0x0 0xd830000 0x0 0x1000>;
	};

	dbg_apmcu_mp1@0d840000 {
		compatible = "mediatek,dbg_apmcu_mp1";
		reg = <0x0 0xd840000 0x0 0x1000>;
	};

	dbg_apmcu_mp1@0d910000 {
		compatible = "mediatek,dbg_apmcu_mp1";
		reg = <0x0 0xd910000 0x0 0x1000>;
	};

	dbg_apmcu_mp1@0d920000 {
		compatible = "mediatek,dbg_apmcu_mp1";
		reg = <0x0 0xd920000 0x0 0x1000>;
	};

	dbg_apmcu_mp1@0d930000 {
		compatible = "mediatek,dbg_apmcu_mp1";
		reg = <0x0 0xd930000 0x0 0x1000>;
	};

	dbg_apmcu_mp1@0d940000 {
		compatible = "mediatek,dbg_apmcu_mp1";
		reg = <0x0 0xd940000 0x0 0x1000>;
	};

	dbg_apmcu_mp1@0da10000 {
		compatible = "mediatek,dbg_apmcu_mp1";
		reg = <0x0 0xda10000 0x0 0x1000>;
	};

	dbg_apmcu_mp1@0da20000 {
		compatible = "mediatek,dbg_apmcu_mp1";
		reg = <0x0 0xda20000 0x0 0x1000>;
	};

	dbg_apmcu_mp1@0da30000 {
		compatible = "mediatek,dbg_apmcu_mp1";
		reg = <0x0 0xda30000 0x0 0x1000>;
	};

	dbg_apmcu_mp1@0da40000 {
		compatible = "mediatek,dbg_apmcu_mp1";
		reg = <0x0 0xda40000 0x0 0x1000>;
	};

	dbg_apmcu_mp1@0db10000 {
		compatible = "mediatek,dbg_apmcu_mp1";
		reg = <0x0 0xdb10000 0x0 0x1000>;
	};

	dbg_apmcu_mp1@0db20000 {
		compatible = "mediatek,dbg_apmcu_mp1";
		reg = <0x0 0xdb20000 0x0 0x1000>;
	};

	dbg_apmcu_mp1@0db30000 {
		compatible = "mediatek,dbg_apmcu_mp1";
		reg = <0x0 0xdb30000 0x0 0x1000>;
	};

	dbg_apmcu_mp1@0db40000 {
		compatible = "mediatek,dbg_apmcu_mp1";
		reg = <0x0 0xdb40000 0x0 0x1000>;
	};

	ap_dma@11000000 {
		compatible = "mediatek,ap_dma";
		reg = <0x0 0x11000000 0x0 0x1000>;
		interrupts = <0x0 0x29 0x8>;
	};

	auxadc@11001000 {
		compatible = "mediatek,auxadc";
		reg = <0x0 0x11001000 0x0 0x1000>;
		interrupts = <0x0 0x14 0x2>;
		clocks = <0x20 0x21>;
		clock-names = "auxadc-main";
		linux,phandle = <0x78>;
		phandle = <0x78>;
	};

	dma-controller@11000580 {
		compatible = "mediatek,mt6577-uart-dma";
		reg = <0x0 0x11000680 0x0 0x80 0x0 0x11000700 0x0 0x80 0x0 0x11000780 0x0 0x80 0x0 0x11000800 0x0 0x80>;
		interrupts = <0x0 0x35 0x8 0x0 0x36 0x8 0x0 0x37 0x8 0x0 0x3c 0x8>;
		clocks = <0x20 0x26>;
		clock-names = "apdma";
		#dma-cells = <0x1>;
		linux,phandle = <0x2d>;
		phandle = <0x2d>;
	};

	serial@11020000 {
		compatible = "mediatek,mt6761-uart", "mediatek,mt6577-uart";
		reg = <0x0 0x11002000 0x0 0x1000>;
		interrupts = <0x0 0x23 0x8>;
		clocks = <0x1b 0x20 0x16>;
		clock-names = "baud", "bus";
		dmas = <0x2d 0x0 0x2d 0x1>;
		dma-names = "tx", "rx";
		linux,phandle = <0x79>;
		phandle = <0x79>;
	};

	serial@11030000 {
		compatible = "mediatek,mt6761-uart", "mediatek,mt6577-uart";
		reg = <0x0 0x11003000 0x0 0x1000>;
		interrupts = <0x0 0x24 0x8>;
		clocks = <0x1b 0x20 0x17>;
		clock-names = "baud", "bus";
		linux,phandle = <0x7a>;
		phandle = <0x7a>;
	};

	pwm@11006000 {
		compatible = "mediatek,pwm";
		reg = <0x0 0x11006000 0x0 0x1000>;
		interrupts = <0x0 0x15 0x8>;
		clocks = <0x20 0x10 0x20 0x11 0x20 0x12 0x20 0x13 0x20 0x14 0x20 0x30 0x20 0xf 0x20 0x15>;
		clock-names = "PWM1-main", "PWM2-main", "PWM3-main", "PWM4-main", "PWM5-main", "PWM6-main", "PWM-HCLK-main", "PWM-main";
		linux,phandle = <0x7b>;
		phandle = <0x7b>;
	};

	i2c_common {
		compatible = "mediatek,i2c_common";
		dma_support = [02];
		idvfs = [01];
		set_dt_div = [01];
		check_max_freq = [01];
		ver = [02];
		set_ltiming = [01];
		ext_time_config = [18 01];
		cnt_constraint = [01];
		linux,phandle = <0x7c>;
		phandle = <0x7c>;
	};

	i2c0@11007000 {
		compatible = "mediatek,i2c";
		id = <0x0>;
		reg = <0x0 0x11007000 0x0 0x1000 0x0 0x11000080 0x0 0x80>;
		interrupts = <0x0 0x1c 0x8>;
		clocks = <0x20 0xb 0x20 0x26>;
		clock-names = "main", "dma";
		clock-div = <0x5>;
		aed = <0x1a>;
		mediatek,hs_only;
		linux,phandle = <0x7d>;
		phandle = <0x7d>;
	};

	i2c1@11008000 {
		compatible = "mediatek,i2c";
		id = <0x1>;
		reg = <0x0 0x11008000 0x0 0x1000 0x0 0x11000100 0x0 0x80>;
		interrupts = <0x0 0x1d 0x8>;
		clocks = <0x20 0xb 0x20 0x26>;
		clock-names = "main", "dma";
		clock-div = <0x5>;
		aed = <0x1a>;
		mediatek,hs_only;
		linux,phandle = <0x7e>;
		phandle = <0x7e>;
	};

	i2c2@11009000 {
		compatible = "mediatek,i2c";
		id = <0x2>;
		reg = <0x0 0x11009000 0x0 0x1000 0x0 0x11000180 0x0 0x180>;
		interrupts = <0x0 0x1e 0x8>;
		clocks = <0x20 0xb 0x20 0x26>;
		clock-names = "main", "dma";
		clock-div = <0x5>;
		aed = <0x1a>;
		ch_offset_default = <0x100>;
		ch_offset_ccu = <0x200>;
		mediatek,hs_only;
		linux,phandle = <0x7f>;
		phandle = <0x7f>;
	};

	i2c3@1100f000 {
		compatible = "mediatek,i2c";
		id = <0x3>;
		reg = <0x0 0x1100f000 0x0 0x1000 0x0 0x11000300 0x0 0x100>;
		interrupts = <0x0 0x1f 0x8>;
		clocks = <0x20 0xb 0x20 0x26>;
		clock-names = "main", "dma";
		clock-div = <0x5>;
		aed = <0x1a>;
		ch_offset_default = <0x100>;
		mediatek,hs_only;
		linux,phandle = <0x80>;
		phandle = <0x80>;
	};

	i2c4@11011000 {
		compatible = "mediatek,i2c";
		id = <0x4>;
		reg = <0x0 0x11011000 0x0 0x1000 0x0 0x11000400 0x0 0x180>;
		interrupts = <0x0 0x20 0x8>;
		clocks = <0x20 0xb 0x20 0x26>;
		clock-names = "main", "dma";
		clock-div = <0x5>;
		aed = <0x1a>;
		ch_offset_default = <0x100>;
		ch_offset_ccu = <0x200>;
		mediatek,hs_only;
		linux,phandle = <0x81>;
		phandle = <0x81>;
	};

	i2c5@11016000 {
		compatible = "mediatek,i2c";
		id = <0x5>;
		reg = <0x0 0x11016000 0x0 0x1000 0x0 0x11000580 0x0 0x80>;
		interrupts = <0x0 0x4a 0x8>;
		clocks = <0x20 0xb 0x20 0x26>;
		clock-names = "main", "dma";
		clock-div = <0x5>;
		aed = <0x1a>;
		mediatek,hs_only;
		linux,phandle = <0x82>;
		phandle = <0x82>;
	};

	i2c6@1100d000 {
		compatible = "mediatek,i2c";
		id = <0x6>;
		reg = <0x0 0x1100d000 0x0 0x1000 0x0 0x11000600 0x0 0x80>;
		interrupts = <0x0 0x4b 0x8>;
		clocks = <0x20 0xb 0x20 0x26>;
		clock-names = "main", "dma";
		clock-div = <0x5>;
		aed = <0x1a>;
		ch_offset_default = <0x100>;
		ch_offset_ccu = <0x200>;
		mediatek,hs_only;
		linux,phandle = <0x83>;
		phandle = <0x83>;
	};

	i2c7 {
		linux,phandle = <0x84>;
		phandle = <0x84>;
	};

	i2c8 {
		linux,phandle = <0x85>;
		phandle = <0x85>;
	};

	i2c9 {
		linux,phandle = <0x86>;
		phandle = <0x86>;
	};

	spi0@1100a000 {
		compatible = "mediatek,mt6765-spi";
		mediatek,pad-select = <0x0>;
		reg = <0x0 0x1100a000 0x0 0x1000>;
		interrupts = <0x0 0x3e 0x8>;
		clocks = <0x19 0xd 0x19 0x74 0x20 0x1b>;
		clock-names = "parent-clk", "sel-clk", "spi-clk";
		linux,phandle = <0x87>;
		phandle = <0x87>;
	};

	therm_ctrl@1100b000 {
		compatible = "mediatek,therm_ctrl";
		reg = <0x0 0x1100b000 0x0 0x1000>;
		interrupts = <0x0 0x16 0x8>;
		clocks = <0x20 0xa>;
		clock-names = "therm-main";
	};

	eem_fsm@1100b000 {
		compatible = "mediatek,eem_fsm";
		reg = <0x0 0x1100b000 0x0 0x1000>;
		interrupts = <0x0 0x45 0x8>;
	};

	btif@1100c000 {
		compatible = "mediatek,btif";
		reg = <0x0 0x1100c000 0x0 0x1000 0x0 0x11000880 0x0 0x80 0x0 0x11000900 0x0 0x80>;
		interrupts = <0x0 0x38 0x8 0x0 0x4c 0x8 0x0 0x4d 0x8>;
		clocks = <0x20 0x1a 0x20 0x26>;
		clock-names = "btifc", "apdmac";
	};

	consys@18002000 {
		compatible = "mediatek,mt6761-consys";
		#address-cells = <0x2>;
		#size-cells = <0x2>;
		reg = <0x0 0x18002000 0x0 0x1000 0x0 0x10007000 0x0 0x100 0x0 0x10001000 0x0 0x1000 0x0 0x10006000 0x0 0x1000 0x0 0x18007000 0x0 0x1000 0x0 0x180b1000 0x0 0x1000 0x0 0x180a3000 0x0 0x1000 0x0 0x180a5000 0x0 0x800 0x0 0x180c1000 0x0 0x1000 0x0 0x18004000 0x0 0x1000>;
		interrupts = <0x0 0xd3 0x8 0x0 0xd5 0x8 0x0 0xd6 0x1>;
		clocks = <0x21 0x1>;
		clock-names = "conn";
		linux,phandle = <0xf>;
		phandle = <0xf>;
	};

	wifi@18000000 {
		compatible = "mediatek,wifi";
		reg = <0x0 0x18000000 0x0 0x100000>;
		interrupts = <0x0 0xd4 0x8>;
	};

	disp_pwm@1100e000 {
		compatible = "mediatek,disp_pwm";
		reg = <0x0 0x1100e000 0x0 0x1000>;
	};

	spi1@11010000 {
		compatible = "mediatek,mt6765-spi";
		mediatek,pad-select = <0x0>;
		reg = <0x0 0x11010000 0x0 0x1000>;
		interrupts = <0x0 0x42 0x8>;
		clocks = <0x19 0xd 0x19 0x74 0x20 0x34>;
		clock-names = "parent-clk", "sel-clk", "spi-clk";
		linux,phandle = <0x88>;
		phandle = <0x88>;
	};

	spi2@11012000 {
		compatible = "mediatek,mt6765-spi";
		mediatek,pad-select = <0x0>;
		reg = <0x0 0x11012000 0x0 0x1000>;
		interrupts = <0x0 0x48 0x8>;
		clocks = <0x19 0xd 0x19 0x74 0x20 0x37>;
		clock-names = "parent-clk", "sel-clk", "spi-clk";
		linux,phandle = <0x89>;
		phandle = <0x89>;
	};

	spi3@11013000 {
		compatible = "mediatek,mt6765-spi";
		mediatek,pad-select = <0x0>;
		reg = <0x0 0x11013000 0x0 0x1000>;
		interrupts = <0x0 0x49 0x8>;
		clocks = <0x19 0xd 0x19 0x74 0x20 0x38>;
		clock-names = "parent-clk", "sel-clk", "spi-clk";
		linux,phandle = <0x8a>;
		phandle = <0x8a>;
	};

	spi4@11014000 {
		compatible = "mediatek,mt6765-spi";
		mediatek,pad-select = <0x0>;
		reg = <0x0 0x11014000 0x0 0x1000>;
		interrupts = <0x0 0x27 0x8>;
		clocks = <0x19 0xd 0x19 0x74 0x20 0x41>;
		clock-names = "parent-clk", "sel-clk", "spi-clk";
		linux,phandle = <0x8b>;
		phandle = <0x8b>;
	};

	spi5@11015000 {
		compatible = "mediatek,mt6765-spi";
		mediatek,pad-select = <0x0>;
		reg = <0x0 0x11015000 0x0 0x1000>;
		interrupts = <0x0 0x28 0x8>;
		clocks = <0x19 0xd 0x19 0x74 0x20 0x42>;
		clock-names = "parent-clk", "sel-clk", "spi-clk";
		linux,phandle = <0x8c>;
		phandle = <0x8c>;
	};

	imp_iic@11017000 {
		compatible = "mediatek,imp_iic";
		reg = <0x0 0x11017000 0x0 0x1000>;
	};

	nfi@11018000 {
		compatible = "mediatek,nfi";
		reg = <0x0 0x11018000 0x0 0x1000>;
	};

	nfiecc@11019000 {
		compatible = "mediatek,nfiecc";
		reg = <0x0 0x11019000 0x0 0x1000>;
	};

	usb0@11200000 {
		compatible = "mediatek,mt6761-usb20";
		reg = <0x0 0x11200000 0x0 0x10000 0x0 0x11cc0000 0x0 0x10000>;
		interrupts = <0x0 0x11 0x8>;
		mode = <0x2>;
		multipoint = <0x1>;
		num_eps = <0x10>;
		clocks = <0x20 0x8 0x19 0x7f 0x19 0x23>;
		clock-names = "usb0", "usb0_clk_top_sel", "usb0_clk_univpll3_d4";
	};

	usb_sif@11210000 {
		compatible = "mediatek,usb_sif";
		reg = <0x0 0x11210000 0x0 0x1000>;
	};

	msdc@11230000 {
		compatible = "mediatek,msdc";
		reg = <0x0 0x11230000 0x0 0x10000>;
		interrupts = <0x0 0x17 0x8>;
		index = [00];
		clk_src = [01];
		bus-width = <0x8>;
		max-frequency = <0xbebc200>;
		cap-mmc-highspeed;
		mmc-ddr-1_8v;
		mmc-hs200-1_8v;
		mmc-hs400-1_8v;
		no-sd;
		no-sdio;
		non-removable;
		pinctl = <0x2e>;
		pinctl_hs400 = <0x2f>;
		pinctl_hs200 = <0x30>;
		register_setting = <0x31>;
		host_function = [00];
		bootable;
		status = "okay";
		vmmc-supply = <0x32>;
		clocks = <0x20 0x4f 0x20 0x1c 0x20 0x45>;
		clock-names = "msdc0-clock", "msdc0-hclock", "msdc0-aes-clock";
		linux,phandle = <0x8d>;
		phandle = <0x8d>;
	};

	msdc@11240000 {
		compatible = "mediatek,msdc";
		reg = <0x0 0x11240000 0x0 0x10000>;
		interrupts = <0x0 0x18 0x8>;
		index = [01];
		clk_src = [02];
		bus-width = <0x4>;
		max-frequency = <0xbebc200>;
		cap-sd-highspeed;
		sd-uhs-sdr12;
		sd-uhs-sdr25;
		sd-uhs-sdr50;
		sd-uhs-sdr104;
		sd-uhs-ddr50;
		no-mmc;
		no-sdio;
		pinctl = <0x33>;
		pinctl_sdr104 = <0x34>;
		pinctl_sdr50 = <0x35>;
		pinctl_ddr50 = <0x36>;
		register_setting = <0x37>;
		host_function = [01];
		cd_level = [01];
		cd-gpios = <0x1c 0x1 0x0>;
		status = "okay";
		vmmc-supply = <0x38>;
		vqmmc-supply = <0x39>;
		clocks = <0x20 0x50 0x20 0x1d>;
		clock-names = "msdc1-clock", "msdc1-hclock";
		linux,phandle = <0x8e>;
		phandle = <0x8e>;
	};

	msdc@11250000 {
		compatible = "mediatek,msdc2";
		reg = <0x0 0x11250000 0x0 0x10000>;
		status = "disable";
		linux,phandle = <0x8f>;
		phandle = <0x8f>;
	};

	msdc@11260000 {
		compatible = "mediatek,msdc3";
		reg = <0x0 0x11250000 0x0 0x10000>;
		status = "disable";
		linux,phandle = <0x90>;
		phandle = <0x90>;
	};

	msdc1_ins@0 {
		compatible = "mediatek,mt6761-sdcard-ins";
		linux,phandle = <0x91>;
		phandle = <0x91>;
	};

	msdc0_top@11cd0000 {
		compatible = "mediatek,msdc0_top";
		reg = <0x0 0x11cd0000 0x0 0x1000>;
	};

	msdc1_top@11c90000 {
		compatible = "mediatek,msdc1_top";
		reg = <0x0 0x11c90000 0x0 0x1000>;
	};

	usb1p_sif@11210000 {
		compatible = "mediatek,usb1p_sif";
		reg = <0x0 0x11210000 0x0 0x10000>;
	};

	btcvsd@10001000 {
		compatible = "mediatek,audio_bt_cvsd";
		offset = <0xf00 0x800 0x140 0x144 0x148>;
		reg = <0x0 0x10001000 0x0 0x1000 0x0 0x18050000 0x0 0x1000 0x0 0x18080000 0x0 0x10000>;
		interrupts = <0x0 0xd2 0x8>;
	};

	audio@11220000 {
		compatible = "mediatek,audio", "syscon";
		reg = <0x0 0x11220000 0x0 0x1000>;
		#clock-cells = <0x1>;
		linux,phandle = <0x3a>;
		phandle = <0x3a>;
	};

	mt_soc_dl1_pcm@11220000 {
		compatible = "mediatek,mt_soc_pcm_dl1";
		reg = <0x0 0x11220000 0x0 0x1000>;
		interrupts = <0x0 0x61 0x8>;
		clocks = <0x3a 0x0 0x3a 0x4 0x3a 0x5 0x3a 0x3 0x3a 0x1 0x3a 0x2 0x3a 0x6 0x20 0x2b 0x20 0x33 0x19 0x78 0x19 0x79 0x19 0x5 0x19 0x7a 0x19 0x2b 0x19 0x7b 0x19 0x2e 0x3b 0x6 0x1b>;
		clock-names = "aud_afe_clk", "aud_dac_clk", "aud_dac_predis_clk", "aud_adc_clk", "aud_apll22m_clk", "aud_apll1_tuner_clk", "aud_tml_clk", "aud_infra_clk", "mtkaif_26m_clk", "top_mux_audio", "top_mux_audio_int", "top_sys_pll1_d4", "top_mux_aud_1", "top_apll1_ck", "top_mux_aud_eng1", "top_apll1_d8", "apmixed_apll1", "top_clk26m_clk";
		linux,phandle = <0x92>;
		phandle = <0x92>;
	};

	audio_sram@11221000 {
		compatible = "mediatek,audio_sram";
		reg = <0x0 0x11221000 0x0 0x9000>;
	};

	mipi_rx_ana_csi0a@11c10000 {
		compatible = "mediatek,mipi_rx_ana_csi0a", "syscon";
		reg = <0x0 0x11c10000 0x0 0x1000>;
		#clock-cells = <0x1>;
		linux,phandle = <0x3d>;
		phandle = <0x3d>;
	};

	mipi_rx_ana_csi1@11c20000 {
		compatible = "mediatek,mipi_rx_ana_csi1";
		reg = <0x0 0x11c20000 0x0 0x10000>;
	};

	mipi_rx_ana_csi0b@11c11000 {
		compatible = "mediatek,mipi_rx_ana_csi0b", "syscon";
		reg = <0x0 0x11c11000 0x0 0x1000>;
		#clock-cells = <0x1>;
		linux,phandle = <0x3e>;
		phandle = <0x3e>;
	};

	mipi_rx_ana_csi1a@11c12000 {
		compatible = "mediatek,mipi_rx_ana_csi1a", "syscon";
		reg = <0x0 0x11c12000 0x0 0x1000>;
		#clock-cells = <0x1>;
		linux,phandle = <0x3f>;
		phandle = <0x3f>;
	};

	mipi_rx_ana_csi1b@11c13000 {
		compatible = "mediatek,mipi_rx_ana_csi1b", "syscon";
		reg = <0x0 0x11c13000 0x0 0x1000>;
		#clock-cells = <0x1>;
		linux,phandle = <0x40>;
		phandle = <0x40>;
	};

	mipi_rx_ana_csi2a@11c14000 {
		compatible = "mediatek,mipi_rx_ana_csi2a", "syscon";
		reg = <0x0 0x11c14000 0x0 0x1000>;
		#clock-cells = <0x1>;
		linux,phandle = <0x41>;
		phandle = <0x41>;
	};

	mipi_rx_ana_csi2b@11c15000 {
		compatible = "mediatek,mipi_rx_ana_csi2b", "syscon";
		reg = <0x0 0x11c15000 0x0 0x1000>;
		#clock-cells = <0x1>;
		linux,phandle = <0x42>;
		phandle = <0x42>;
	};

	mipi_rx_ana_csi2@11c30000 {
		compatible = "mediatek,mipi_rx_ana_csi2";
		reg = <0x0 0x11c30000 0x0 0x10000>;
	};

	efusec@11c50000 {
		compatible = "mediatek,efusec";
		reg = <0x0 0x11c50000 0x0 0x10000>;
	};

	mipi_tx0@11c80000 {
		compatible = "mediatek,mipi_tx0";
		reg = <0x0 0x11c80000 0x0 0x10000>;
	};

	msdc1_pad_macro@11c90000 {
		compatible = "mediatek,msdc1_pad_macro";
		reg = <0x0 0x11c90000 0x0 0x10000>;
	};

	msdc0_pad_macro@11cd0000 {
		compatible = "mediatek,msdc0_pad_macro";
		reg = <0x0 0x11cd0000 0x0 0x10000>;
	};

	mfg_clark@13000000 {
		compatible = "mediatek,clark";
		reg = <0x0 0x13000000 0x0 0x80000>;
		interrupts = <0x0 0xcb 0x8>;
		interrupt-names = "RGX";
		clock-frequency = <0x21f98280>;
	};

	mfg_cfg@13ffe000 {
		compatible = "mediatek,mfgcfg", "syscon";
		reg = <0x0 0x13ffe000 0x0 0x1000>;
		#clock-cells = <0x1>;
		linux,phandle = <0x93>;
		phandle = <0x93>;
	};

	gpufreq {
		compatible = "mediatek,mt6761-gpufreq";
		clocks = <0x19 0x6d 0x19 0x28 0x1b 0x21 0x7 0x21 0x4 0x21 0x6>;
		clock-names = "clk_mux", "clk_main_parent", "clk_sub_parent", "mtcmos_mfg_async", "mtcmos_mfg", "mtcmos_mfg_core0";
	};

	mmsys_config@14000000 {
		compatible = "mediatek,mmsys_config", "syscon";
		reg = <0x0 0x14000000 0x0 0x1000>;
		interrupts = <0x0 0xab 0x8>;
		#clock-cells = <0x1>;
		clocks = <0x22 0x17 0x22 0x1a 0x22 0x1b>;
		clock-names = "CAM_MDP", "IMG_DL_RELAY", "IMG_DL_ASYNC_TOP";
		linux,phandle = <0x22>;
		phandle = <0x22>;
	};

	nfc {
		compatible = "mediatek,nfc-gpio-v2";
		gpio-rst = <0xac>;
		gpio-rst-std = <0x1c 0xac 0x0>;
		gpio-irq = <0xa>;
		gpio-irq-std = <0x1c 0xa 0x0>;
		linux,phandle = <0x94>;
		phandle = <0x94>;
	};

	irq_nfc {
		compatible = "mediatek,irq_nfc-eint";
		linux,phandle = <0x95>;
		phandle = <0x95>;
	};

	disp_mutex0@14001000 {
		compatible = "mediatek,disp_mutex0";
		reg = <0x0 0x14001000 0x0 0x1000>;
		interrupts = <0x0 0x9a 0x8>;
		linux,phandle = <0x2b>;
		phandle = <0x2b>;
	};

	smi_common@14002000 {
		compatible = "mediatek,smi_common";
		reg = <0x0 0x14002000 0x0 0x1000>;
		nr_larbs = <0x3>;
		larbs = <0x1d 0x1e 0x1f>;
		mmsys_config = <0x22>;
		clocks = <0x21 0x3 0x22 0x15 0x22 0x16 0x22 0x13>;
		clock-names = "mtcmos-dis", "smi-comm0", "smi-comm1", "smi-common";
	};

	mmdvfs_pmqos {
		compatible = "mediatek,mmdvfs_pmqos";
		mm_step0 = <0x1b4 0x1 0x0 0x1>;
		mm_step0_ext = <0x1b4 0x2 0x6 0x10c4ec>;
		mm_step1 = <0x138 0x1 0x0 0x2>;
		mm_step1_ext = <0x138 0x2 0x6 0x10c4ec>;
		mm_step2 = <0xe3 0x1 0x0 0x3>;
		mm_step2_ext = <0xe3 0x2 0x6 0x117627>;
		vopp_steps = <0x0 0x1 0x3>;
		disp_freq = "mm_step0", "mm_step1", "mm_step2";
		mdp_freq = "mm_step0", "mm_step1", "mm_step2";
		cam_freq = "mm_step0", "mm_step1", "mm_step2";
		img_freq = "mm_step0", "mm_step1", "mm_step2";
		vdec_freq = "mm_step0", "mm_step1", "mm_step2";
		venc_freq = "mm_step0", "mm_step1", "mm_step2";
		clocks = <0x19 0x6b 0x19 0x24 0x19 0x1a 0x19 0x25>;
		clock-names = "mmdvfs_clk_mm_sel_ck", "mmdvfs_clk_mmpll_ck", "mmdvfs_clk_univpll1_d2_ck", "mmdvfs_clk_mmpll_d2_ck";
	};

	smi_larb0@14003000 {
		cell-index = <0x0>;
		compatible = "mediatek,smi_larb0", "mediatek,smi_larb";
		reg = <0x0 0x14003000 0x0 0x1000>;
		clocks = <0x21 0x3 0x22 0x14>;
		clock-names = "mtcmos-dis", "smi-larb0";
		linux,phandle = <0x1d>;
		phandle = <0x1d>;
	};

	mdp_rdma0@14004000 {
		compatible = "mediatek,mdp_rdma0";
		reg = <0x0 0x14004000 0x0 0x1000>;
		interrupts = <0x0 0x9b 0x8>;
		clocks = <0x22 0x0>;
		clock-names = "MDP_RDMA0";
		linux,phandle = <0x23>;
		phandle = <0x23>;
	};

	mdp_ccorr0@14005000 {
		compatible = "mediatek,mdp_ccorr0";
		reg = <0x0 0x14005000 0x0 0x1000>;
		interrupts = <0x0 0xaa 0x8>;
		clocks = <0x22 0x1>;
		clock-names = "MDP_CCORR";
		linux,phandle = <0x2a>;
		phandle = <0x2a>;
	};

	mdp_rsz0@14006000 {
		compatible = "mediatek,mdp_rsz0";
		reg = <0x0 0x14006000 0x0 0x1000>;
		interrupts = <0x0 0x9c 0x8>;
		clocks = <0x22 0x2>;
		clock-names = "MDP_RSZ0";
		linux,phandle = <0x24>;
		phandle = <0x24>;
	};

	mdp_rsz1@14007000 {
		compatible = "mediatek,mdp_rsz1";
		reg = <0x0 0x14007000 0x0 0x1000>;
		interrupts = <0x0 0x9d 0x8>;
		clocks = <0x22 0x3>;
		clock-names = "MDP_RSZ1";
		linux,phandle = <0x25>;
		phandle = <0x25>;
	};

	mdp_wdma0@14008000 {
		compatible = "mediatek,mdp_wdma0";
		reg = <0x0 0x14008000 0x0 0x1000>;
		interrupts = <0x0 0xa0 0x8>;
		clocks = <0x22 0x6>;
		clock-names = "MDP_WDMA";
		linux,phandle = <0x26>;
		phandle = <0x26>;
	};

	mdp_wrot0@14009000 {
		compatible = "mediatek,mdp_wrot0";
		reg = <0x0 0x14009000 0x0 0x1000>;
		interrupts = <0x0 0x9f 0x8>;
		clocks = <0x22 0x5>;
		clock-names = "MDP_WROT0";
		linux,phandle = <0x27>;
		phandle = <0x27>;
	};

	mdp_tdshp0@1400a000 {
		compatible = "mediatek,mdp_tdshp0";
		reg = <0x0 0x1400a000 0x0 0x1000>;
		clocks = <0x22 0x4>;
		clock-names = "MDP_TDSHP";
		linux,phandle = <0x28>;
		phandle = <0x28>;
	};

	disp_ovl0@1400b000 {
		compatible = "mediatek,disp_ovl0";
		reg = <0x0 0x1400b000 0x0 0x1000>;
		interrupts = <0x0 0xa1 0x8>;
	};

	disp_ovl0_2l@1400c000 {
		compatible = "mediatek,disp_ovl0_2l";
		reg = <0x0 0x1400c000 0x0 0x1000>;
		interrupts = <0x0 0xad 0x8>;
	};

	disp_rdma0@1400d000 {
		compatible = "mediatek,disp_rdma0";
		reg = <0x0 0x1400d000 0x0 0x1000>;
		interrupts = <0x0 0xa2 0x8>;
	};

	disp_wdma0@1400e000 {
		compatible = "mediatek,disp_wdma0";
		reg = <0x0 0x1400e000 0x0 0x1000>;
		interrupts = <0x0 0xa3 0x8>;
	};

	disp_color0@1400f000 {
		compatible = "mediatek,disp_color0";
		reg = <0x0 0x1400f000 0x0 0x1000>;
		interrupts = <0x0 0xa4 0x8>;
		linux,phandle = <0x29>;
		phandle = <0x29>;
	};

	disp_ccorr0@14010000 {
		compatible = "mediatek,disp_ccorr0";
		reg = <0x0 0x14010000 0x0 0x1000>;
		interrupts = <0x0 0xa5 0x8>;
	};

	disp_aal0@14011000 {
		compatible = "mediatek,disp_aal0";
		reg = <0x0 0x14011000 0x0 0x1000>;
		interrupts = <0x0 0xa6 0x8>;
	};

	disp_gamma0@14012000 {
		compatible = "mediatek,disp_gamma0";
		reg = <0x0 0x14012000 0x0 0x1000>;
		interrupts = <0x0 0xa7 0x8>;
	};

	disp_dither0@14013000 {
		compatible = "mediatek,disp_dither0";
		reg = <0x0 0x14013000 0x0 0x1000>;
		interrupts = <0x0 0xa8 0x8>;
	};

	dsi0@14014000 {
		compatible = "mediatek,dsi0";
		reg = <0x0 0x14014000 0x0 0x1000>;
		interrupts = <0x0 0xa9 0x8>;
	};

	disp_rsz0@14015000 {
		compatible = "mediatek,disp_rsz0";
		reg = <0x0 0x14015000 0x0 0x1000>;
		interrupts = <0x0 0xdc 0x8>;
	};

	mtkfb@0 {
		compatible = "mediatek,mtkfb";
		linux,phandle = <0x96>;
		phandle = <0x96>;
	};

	dispsys {
		compatible = "mediatek,dispsys";
		mediatek,larb = <0x1d>;
		clocks = <0x21 0x3 0x22 0x13 0x22 0x14 0x22 0x15 0x22 0x16 0x22 0x7 0x22 0x8 0x22 0xa 0x22 0xb 0x22 0xc 0x22 0xd 0x22 0xe 0x22 0xf 0x22 0x10 0x22 0x11 0x22 0x1c 0x22 0x1d 0x22 0x9 0x3b 0x13 0x19 0x7c 0x20 0x31 0x1b 0x19 0x1e 0x19 0x2f 0x19 0x31>;
		clock-names = "MMSYS_MTCMOS", "MMSYS_SMI_COMMON", "MMSYS_SMI_LARB0", "MMSYS_GALS_COMM0", "MMSYS_GALS_COMM1", "MMSYS_DISP_OVL0", "MMSYS_DISP_OVL0_2L", "MMSYS_DISP_RDMA0", "MMSYS_DISP_WDMA0", "MMSYS_DISP_COLOR0", "MMSYS_DISP_CCORR0", "MMSYS_DISP_AAL0", "MMSYS_DISP_GAMMA0", "MMSYS_DISP_DITHER0", "MMSYS_DSI0_MM_CK", "MMSYS_DSI0_IF_CK", "MMSYS_26M", "MMSYS_DISP_RSZ0", "APMIXED_MIPI_26M", "TOP_MUX_DISP_PWM", "DISP_PWM", "TOP_26M", "TOP_UNIVPLL2_D4", "TOP_ULPOSC1_D2", "TOP_ULPOSC1_D8";
	};

	swtp {
		compatible = "mediatek, swtp-eint";
		linux,phandle = <0x97>;
		phandle = <0x97>;
	};

	dsi_te {
		compatible = "mediatek, DSI_TE-eint";
		status = "disabled";
		linux,phandle = <0x98>;
		phandle = <0x98>;
	};

	mm_mutex@14016000 {
		compatible = "mediatek,mm_mutex";
		reg = <0x0 0x14016000 0x0 0x1000>;
		linux,phandle = <0x99>;
		phandle = <0x99>;
	};

	camsys@15000000 {
		compatible = "mediatek,camsys", "syscon";
		reg = <0x0 0x15000000 0x0 0x1000>;
		#clock-cells = <0x1>;
		linux,phandle = <0x3c>;
		phandle = <0x3c>;
	};

	ispsys@15000000 {
		compatible = "mediatek,mt6761-ispsys";
		reg = <0x0 0x15004000 0x0 0x9000 0x0 0x1500d000 0x0 0x1000 0x0 0x15000000 0x0 0x52000 0x0 0x15040000 0x0 0x8000 0x0 0x10215000 0x0 0x3000 0x0 0x10211000 0x0 0x1000>;
		interrupts = <0x0 0xb3 0x8 0x0 0xb4 0x8 0x0 0xb5 0x8 0x0 0xb8 0x8 0x0 0xb9 0x8 0x0 0xba 0x8 0x0 0xbb 0x8>;
		clocks = <0x21 0x3 0x21 0x8 0x3c 0x0 0x3c 0x1 0x3c 0x2 0x3c 0x3 0x3c 0x4 0x3c 0x5 0x22 0x15 0x22 0x16 0x22 0x13>;
		clock-names = "CG_SCP_SYS_DIS", "CG_SCP_SYS_CAM", "CG_CAM_LARB2", "CG_CAM", "CG_CAMTG", "CG_CAM_SENINF", "CG_CAMSV0", "CG_CAMSV1", "CG_MM_SMI_COMM0", "CG_MM_SMI_COMM1", "CG_MM_SMI_COMMON";
	};

	smi_larb2@15001000 {
		cell-index = <0x2>;
		compatible = "mediatek,smi_larb2", "mediatek,smi_larb";
		reg = <0x0 0x15001000 0x0 0x1000>;
		clocks = <0x21 0x8 0x22 0x18 0x3c 0x0>;
		clock-names = "mtcmos-cam", "gals-cam2img", "cam-larb2";
		linux,phandle = <0x1f>;
		phandle = <0x1f>;
	};

	cam@15004000 {
		compatible = "mediatek,cam";
		reg = <0x0 0x15004000 0x0 0x1000>;
	};

	cam_lut@15005000 {
		compatible = "mediatek,cam_lut";
		reg = <0x0 0x15005000 0x0 0x1000>;
	};

	camd@15006000 {
		compatible = "mediatek,camd";
		reg = <0x0 0x15006000 0x0 0x1000>;
	};

	cam_dma@15007000 {
		compatible = "mediatek,cam_dma";
		reg = <0x0 0x15007000 0x0 0x1000>;
	};

	fdvt@1500b000 {
		compatible = "mediatek,fdvt";
		reg = <0x0 0x1500b000 0x0 0x1000>;
		interrupts = <0x0 0xb6 0x8>;
		clocks = <0x3c 0x6>;
		clock-names = "FD_CLK_CAM_FDVT";
	};

	cam_inner@1500d000 {
		compatible = "mediatek,cam_inner";
		reg = <0x0 0x1500d000 0x0 0x1000>;
	};

	camd_inner@1500e000 {
		compatible = "mediatek,camd_inner";
		reg = <0x0 0x1500e000 0x0 0x1000>;
	};

	cam_inner_dma@1500f000 {
		compatible = "mediatek,cam_inner_dma";
		reg = <0x0 0x1500f000 0x0 0x1000>;
	};

	camsv0@15050000 {
		compatible = "mediatek,camsv0";
		reg = <0x0 0x15050000 0x0 0x1000>;
	};

	camsv1@15051000 {
		compatible = "mediatek,camsv1";
		reg = <0x0 0x15051000 0x0 0x1000>;
	};

	kd_camera_hw1@15040000 {
		compatible = "mediatek,camera_hw";
		reg = <0x0 0x15040000 0x0 0x1000>;
		clocks = <0x19 0x6f 0x19 0x70 0x19 0x71 0x19 0x72 0x19 0x16 0x19 0x15 0x19 0x20 0x19 0x13 0x19 0x1f 0x19 0x14 0x1b 0x3c 0x3 0x3b 0xc 0x3b 0x10 0x3d 0x0 0x3e 0x0 0x3f 0x0 0x40 0x0 0x41 0x0 0x42 0x0 0x19 0x86 0x19 0x1d 0x21 0x8>;
		clock-names = "CLK_TOP_CAMTG_SEL", "CLK_TOP_CAMTG1_SEL", "CLK_TOP_CAMTG2_SEL", "CLK_TOP_CAMTG3_SEL", "CLK_MCLK_6M", "CLK_MCLK_12M", "CLK_MCLK_13M", "CLK_MCLK_48M", "CLK_MCLK_52M", "CLK_MCLK_24M", "CLK_MCLK_26M", "CLK_CAM_SENINF_CG", "CLK_MIPI_C0_26M_CG", "CLK_MIPI_C1_26M_CG", "CLK_MIPI_ANA_0A_CG", "CLK_MIPI_ANA_0B_CG", "CLK_MIPI_ANA_1A_CG", "CLK_MIPI_ANA_1B_CG", "CLK_MIPI_ANA_2A_CG", "CLK_MIPI_ANA_2B_CG", "CLK_TOP_CAMTM_SEL_CG", "CLK_TOP_CAMTM_208_CG", "CLK_SCP_SYS_CAM";
		linux,phandle = <0x9a>;
		phandle = <0x9a>;
	};

	flashlight_core {
		compatible = "mediatek,flashlight_core";
		linux,phandle = <0x9b>;
		phandle = <0x9b>;
	};

	flashlights_mt6370 {
		compatible = "mediatek,flashlights_mt6370";
		decouple = <0x0>;
		linux,phandle = <0x9c>;
		phandle = <0x9c>;

		channel@1 {
			type = <0x0>;
			ct = <0x0>;
			part = <0x0>;
		};

		channel@2 {
			type = <0x0>;
			ct = <0x1>;
			part = <0x0>;
		};
	};

	flashlights_ocp8132a {
		compatible = "mediatek,flashlights_ocp8132a";
		linux,phandle = <0x9d>;
		phandle = <0x9d>;
	};

	venc_gcon@17000000 {
		compatible = "mediatek,venc_gcon", "syscon";
		reg = <0x0 0x17000000 0x0 0x10000>;
		clocks = <0x21 0x3 0x21 0x9 0x22 0x15 0x22 0x16 0x22 0x13 0x43 0x3 0x43 0x1>;
		clock-names = "MT_SCP_SYS_DIS", "MT_SCP_SYS_VCODEC", "MT_CG_MM_SMI_COMM0", "MT_CG_MM_SMI_COMM1", "MT_CG_MM_SMI_COMMON", "MT_CG_VDEC", "MT_CG_VENC";
		#clock-cells = <0x1>;
		linux,phandle = <0x43>;
		phandle = <0x43>;
	};

	smi_larb1@17010000 {
		cell-index = <0x1>;
		compatible = "mediatek,smi_larb1", "mediatek,smi_larb";
		reg = <0x0 0x17010000 0x0 0x10000>;
		clocks = <0x21 0x9 0x43 0x1>;
		clock-names = "mtcmos-vcodec", "venc-larb1";
		linux,phandle = <0x1e>;
		phandle = <0x1e>;
	};

	venc@17020000 {
		compatible = "mediatek,venc";
		reg = <0x0 0x17020000 0x0 0x10000>;
		interrupts = <0x0 0xae 0x8>;
	};

	venc_jpg@17030000 {
		compatible = "mediatek,venc_jpg";
		reg = <0x0 0x17030000 0x0 0x10000>;
		interrupts = <0x0 0xb0 0x8>;
		clocks = <0x43 0x2>;
		clock-names = "MT_CG_VENC_JPGENC";
	};

	vdec@17040000 {
		compatible = "mediatek,vdec";
		reg = <0x0 0x17040000 0x0 0x10000>;
		interrupts = <0x0 0xb1 0x8>;
	};

	mbist@17050000 {
		compatible = "mediatek,mbist";
		reg = <0x0 0x17050000 0x0 0x10000>;
	};

	otg_iddig {
		compatible = "mediatek,usb_iddig_bi_eint";
		linux,phandle = <0x9e>;
		phandle = <0x9e>;
	};

	odm {
		compatible = "simple-bus";
		linux,phandle = <0x9f>;
		phandle = <0x9f>;
	};

	radio_md_cfg {
		compatible = "mediatek,radio_md_cfg";
		linux,phandle = <0xa0>;
		phandle = <0xa0>;
	};

	dynamic_options {
		compatible = "mediatek,dynamic_options";
		linux,phandle = <0xa1>;
		phandle = <0xa1>;
	};

	audio_snd_card {
		compatible = "mediatek,audio_snd_card";
	};

	mt_soc_deep_buffer_dl_pcm {
		compatible = "mediatek,mt_soc_pcm_deep_buffer_dl";
	};

	mt_soc_ul1_pcm {
		compatible = "mediatek,mt_soc_pcm_capture";
	};

	mt_soc_voice_md1 {
		compatible = "mediatek,mt_soc_pcm_voice_md1";
	};

	mt_soc_uldlloopback_pcm {
		compatible = "mediatek,mt_soc_pcm_uldlloopback";
	};

	mt_soc_i2s0_pcm {
		compatible = "mediatek,mt_soc_pcm_dl1_i2s0";
	};

	mt_soc_mrgrx_pcm {
		compatible = "mediatek,mt_soc_pcm_mrgrx";
	};

	mt_soc_mrgrx_awb_pcm {
		compatible = "mediatek,mt_soc_pcm_mrgrx_awb";
	};

	mt_soc_fm_i2s_pcm {
		compatible = "mediatek,mt_soc_pcm_fm_i2s";
	};

	mt_soc_fm_i2s_awb_pcm {
		compatible = "mediatek,mt_soc_pcm_fm_i2s_awb";
	};

	mt_soc_i2s0dl1_pcm {
		compatible = "mediatek,mt_soc_pcm_dl1_i2s0dl1";
	};

	mt_soc_dl1_awb_pcm {
		compatible = "mediatek,mt_soc_pcm_dl1_awb";
	};

	mt_soc_voice_md1_bt {
		compatible = "mediatek,mt_soc_pcm_voice_md1_bt";
	};

	mt_soc_voip_bt_out {
		compatible = "mediatek,mt_soc_pcm_dl1_bt";
	};

	mt_soc_voip_bt_in {
		compatible = "mediatek,mt_soc_pcm_bt_dai";
	};

	mt_soc_tdmrx_pcm {
		compatible = "mediatek,mt_soc_tdm_capture";
	};

	mt_soc_fm_mrgtx_pcm {
		compatible = "mediatek,mt_soc_pcm_fmtx";
	};

	mt_soc_ul2_pcm {
		compatible = "mediatek,mt_soc_pcm_capture2";
	};

	mt_soc_i2s0_awb_pcm {
		compatible = "mediatek,mt_soc_pcm_i2s0_awb";
	};

	mt_soc_voice_md2 {
		compatible = "mediatek,mt_soc_pcm_voice_md2";
	};

	mt_soc_routing_pcm {
		compatible = "mediatek,mt_soc_pcm_routing";
	};

	mt_soc_voice_md2_bt {
		compatible = "mediatek,mt_soc_pcm_voice_md2_bt";
	};

	mt_soc_hp_impedance_pcm {
		compatible = "mediatek,mt_soc_pcm_hp_impedance";
	};

	mt_soc_codec_name {
		compatible = "mediatek,mt_soc_codec_63xx";
		use_hp_depop_flow = <0x0>;
		use_ul_260k = <0x0>;
	};

	mt_soc_dummy_pcm {
		compatible = "mediatek,mt_soc_pcm_dummy";
	};

	mt_soc_codec_dummy_name {
		compatible = "mediatek,mt_soc_codec_dummy";
	};

	mt_soc_routing_dai_name {
		compatible = "mediatek,mt_soc_dai_routing";
	};

	mt_soc_dai_name {
		compatible = "mediatek,mt_soc_dai_stub";
	};

	mt_soc_dl2_pcm {
		compatible = "mediatek,mt_soc_pcm_dl2";
	};

	mt_soc_anc_pcm {
		compatible = "mediatek,mt_soc_pcm_anc";
	};

	mt_soc_pcm_voice_ultra {
		compatible = "mediatek,mt_soc_pcm_voice_ultra";
	};

	mt_soc_pcm_voice_usb {
		compatible = "mediatek,mt_soc_pcm_voice_usb";
	};

	mt_soc_pcm_voice_usb_echoref {
		compatible = "mediatek,mt_soc_pcm_voice_usb_echoref";
	};

	mt_soc_btcvsd_rx_pcm {
		compatible = "mediatek,mt_soc_btcvsd_rx_pcm";
	};

	mt_soc_btcvsd_tx_pcm {
		compatible = "mediatek,mt_soc_btcvsd_tx_pcm";
	};

	firmware {

		android {
			compatible = "android,firmware";

			vbmeta {
				compatible = "android,vbmeta";
				parts = "vbmeta,boot,system,vendor";
			};

			fstab {
				compatible = "android,fstab";

				vendor {
					compatible = "android,vendor";
					dev = "/dev/block/platform/bootdevice/by-name/vendor";
					type = "ext4";
					mnt_flags = "ro";
					fsmgr_flags = "wait,slotselect,avb";
				};
			};
		};
	};

	mt_charger {
		compatible = "mediatek,mt-charger";
		linux,phandle = <0xa2>;
		phandle = <0xa2>;
	};

	lk_charger {
		compatible = "mediatek,lk_charger";
		enable_anime;
		enable_pe_plus;
		max_charger_voltage = <0x632ea0>;
		fast_charge_voltage = <0x2dc6c0>;
		usb_charger_current = <0x7a120>;
		ac_charger_current = <0x17a6b0>;
		ac_charger_input_current = <0x16e360>;
		non_std_ac_charger_current = <0xdbba0>;
		charging_host_charger_current = <0x16e360>;
		ta_ac_charger_current = <0x17a6b0>;
		pd_charger_current = <0x7a120>;
		temp_t4_threshold = <0x32>;
		temp_t3_threshold = <0x2d>;
		temp_t1_threshold = <0x0>;
		linux,phandle = <0xa3>;
		phandle = <0xa3>;
	};

	charger {
		compatible = "mediatek,charger";
		algorithm_name = "SwitchCharging";
		enable_sw_jeita;
		enable_pe_plus;
		enable_pe_2;
		enable_pe_3;
		enable_pe_4;
		enable_type_c;
		battery_cv = <0x432380>;
		max_charger_voltage = <0x632ea0>;
		min_charger_voltage = <0x4630c0>;
		usb_charger_current_suspend = <0x0>;
		usb_charger_current_unconfigured = <0x11170>;
		usb_charger_current_configured = <0x7a120>;
		usb_charger_current = <0x7a120>;
		ac_charger_current = <0x17a6b0>;
		ac_charger_input_current = <0x16e360>;
		non_std_ac_charger_current = <0xdbba0>;
		charging_host_charger_current = <0x16e360>;
		apple_1_0a_charger_current = <0x9eb10>;
		apple_2_1a_charger_current = <0xc3500>;
		ta_ac_charger_current = <0x17a6b0>;
		jeita_temp_above_t4_cv = <0x3e8fa0>;
		jeita_temp_t3_to_t4_cv = <0x3e8fa0>;
		jeita_temp_t2_to_t3_cv = <0x432380>;
		jeita_temp_t1_to_t2_cv = <0x432380>;
		jeita_temp_t0_to_t1_cv = <0x432380>;
		jeita_temp_below_t0_cv = <0x432380>;
		jeita_temp_above_t4_cc = <0x0>;
		jeita_temp_t3_to_t4_cc = <0x17a6b0>;
		jeita_temp_t2_to_t3_cc = <0x17a6b0>;
		jeita_temp_t1_to_t2_cc = <0xb71b0>;
		jeita_temp_t0_to_t1_cc = <0x0>;
		jeita_temp_below_t0_cc = <0x0>;
		temp_t4_thres = <0x36>;
		temp_t4_thres_minus_x_degree = <0x34>;
		temp_t3_thres = <0x2d>;
		temp_t3_thres_minus_x_degree = <0x2b>;
		temp_t2_thres = <0xf>;
		temp_t2_thres_plus_x_degree = <0x10>;
		temp_t1_thres = <0x2>;
		temp_t1_thres_plus_x_degree = <0x4>;
		temp_t0_thres = <0x2>;
		temp_t0_thres_plus_x_degree = <0x2>;
		temp_neg_10_thres = <0x2>;
		enable_min_charge_temp;
		min_charge_temp = <0x0>;
		min_charge_temp_plus_x_degree = <0x2>;
		max_charge_temp = <0x36>;
		max_charge_temp_minus_x_degree = <0x34>;
		ta_12v_support;
		ta_9v_support;
		pe_ichg_level_threshold = <0xf4240>;
		ta_ac_12v_input_current = <0x30d400>;
		ta_ac_9v_input_current = <0x30d400>;
		ta_ac_7v_input_current = <0x30d400>;
		pe20_ichg_level_threshold = <0xf4240>;
		ta_start_battery_soc = <0x0>;
		ta_stop_battery_soc = <0x55>;
		pe40_single_charger_input_current = <0x2dc6c0>;
		pe40_single_charger_current = <0x2dc6c0>;
		pe40_dual_charger_input_current = <0x2dc6c0>;
		pe40_dual_charger_chg1_current = <0x1e8480>;
		pe40_dual_charger_chg2_current = <0x1e8480>;
		pe40_stop_battery_soc = <0x50>;
		pe40_r_cable_1a_lower = <0x229>;
		pe40_r_cable_2a_lower = <0x19f>;
		pe40_r_cable_3a_lower = <0x113>;
		chg1_ta_ac_charger_current = <0x16e360>;
		chg2_ta_ac_charger_current = <0x16e360>;
		cable_imp_threshold = <0x2bb>;
		vbat_cable_imp_threshold = <0x3b8260>;
		bif_threshold1 = <0x40d990>;
		bif_threshold2 = <0x419ce0>;
		bif_cv_under_threshold2 = <0x43e6d0>;
		linux,phandle = <0xa4>;
		phandle = <0xa4>;
	};

	rt9465_slave_chr {
		compatible = "richtek,rt9465";
		status = "disabled";
		linux,phandle = <0xa5>;
		phandle = <0xa5>;
	};

	rt-pd-manager {
		compatible = "mediatek,rt-pd-manager";
	};

	mt6370_pmu_eint {
		linux,phandle = <0xa6>;
		phandle = <0xa6>;
	};

	pmic_clock_buffer_ctrl {
		compatible = "mediatek,pmic_clock_buffer";
		mediatek,clkbuf-quantity = <0x7>;
		mediatek,clkbuf-config = <0x2 0x1 0x1 0x2 0x0 0x0 0x0>;
		mediatek,clkbuf-driving-current = <0x1 0x1 0x1 0x1 0x1 0x1 0x1>;
		linux,phandle = <0xa7>;
		phandle = <0xa7>;
	};

	pseudo_m4u {
		compatible = "mediatek,mt-pseudo_m4u";
		iommus = <0x44 0x2>;
	};

	pseudo_m4u-larb0 {
		compatible = "mediatek,mt-pseudo_m4u-port";
		mediatek,larbid = <0x0>;
		iommus = <0x44 0x0 0x44 0x1 0x44 0x2 0x44 0x3 0x44 0x4 0x44 0x5 0x44 0x6 0x44 0x7>;
	};

	pseudo_m4u-larb1 {
		compatible = "mediatek,mt-pseudo_m4u-port";
		mediatek,larbid = <0x1>;
		iommus = <0x44 0x20 0x44 0x21>;
	};

	pseudo_m4u-larb2 {
		compatible = "mediatek,mt-pseudo_m4u-port";
		mediatek,larbid = <0x2>;
		iommus = <0x44 0x40 0x44 0x41>;
	};

	trusty {
		compatible = "android,trusty-smc-v1";
		ranges;
		#address-cells = <0x2>;
		#size-cells = <0x2>;

		irq {
			compatible = "android,trusty-irq-v1";
			ppi-interrupt-parent = <0xd>;
		};

		log {
			compatible = "android,trusty-log-v1";
		};

		virtio {
			compatible = "android,trusty-virtio-v1";
		};

		mtee {
			compatible = "mediatek,trusty-mtee-v1";
		};
	};

	mt6370_pmu_dts {
		interrupt-controller;
		#interrupt-cells = <0x1>;
		mt6370,intr_gpio_num = <0x3>;
		mt6370,intr_gpio = <0x1c 0x3 0x0>;
		linux,phandle = <0xa8>;
		phandle = <0xa8>;

		core {
			compatible = "mediatek,mt6370_pmu_core";
			interrupt-names = "otp", "vdda_ovp", "vdda_uv";
			i2cstmr_rst_tmr = <0x0>;
			mrstb_en;
			mrstb_tmr = <0x3>;
			int_wdt = <0x0>;
			int_deg = <0x0>;
		};

		charger {
			compatible = "mediatek,mt6370_pmu_charger";
			interrupt-names = "chg_mivr", "chg_aiclmeasi", "attachi", "ovpctrl_uvp_d_evt", "chg_wdtmri", "chg_vbusov", "chg_tmri", "chg_treg";
			charger_name = "primary_chg";
			load_switch_name = "primary_load_switch";
			ichg = <0x1e8480>;
			aicr = <0x7a120>;
			mivr = <0x432380>;
			cv = <0x426030>;
			ieoc = <0x249f0>;
			safety_timer = <0xc>;
			dc_wdt = <0x3d0900>;
			ircmp_resistor = <0x61a8>;
			ircmp_vclamp = <0x7d00>;
			enable_te;
			enable_wdt;
		};

		mt6370_pmu_fled1 {
			compatible = "mediatek,mt6370_pmu_fled1";
			interrupt-names = "fled_lvf", "fled2_short", "fled1_short";
			fled_enable = <0x1>;
			torch_cur = <0x493e0>;
			strobe_cur = <0x124f80>;
			strobe_timeout = <0x960>;
		};

		mt6370_pmu_fled2 {
			compatible = "mediatek,mt6370_pmu_fled2";
			fled_enable = <0x1>;
			torch_cur = <0x30d40>;
			strobe_cur = <0xf4240>;
			strobe_timeout = <0x4b0>;
		};

		ldo {
			compatible = "mediatek,mt6370_pmu_ldo";
			interrupt-names = "ldo_oc";
			ldo_oms = <0x1>;
			ldo_vrc_lt = <0x1>;

			mt6370_ldo {
				regulator-name = "irtx_ldo";
				regulator-min-microvolt = <0x186a00>;
				regulator-max-microvolt = <0x3d0900>;
			};
		};

		rgbled {
			compatible = "mediatek,mt6370_pmu_rgbled";
			interrupt-names = "isink4_short", "isink3_short", "isink2_short", "isink1_short", "isink4_open", "isink3_open", "isink2_open", "isink1_open";
			mt,led_name = "mt6370_pmu_led1", "mt6370_pmu_led2", "mt6370_pmu_led3", "mt6370_pmu_led4";
			mt,led_default_trigger = "cc_mode", "cc_mode", "cc_mode", "none";
		};

		bled {
			compatible = "mediatek,mt6370_pmu_bled";
			interrupt-names = "bled_ocp";
			mt,bled_name = "mt6370_pmu_bled";
			mt,chan_en = <0xf>;
			mt,map_linear;
			mt,bl_ovp_level = <0x3>;
			mt,bl_ocp_level = <0x2>;
			mt,use_pwm;
			mt,pwm_fsample = <0x2>;
			mt,pwm_deglitch = <0x1>;
			mt,pwm_avg_cycle = <0x0>;
			mt,bled_ramptime = <0x3>;
			mt,bled_flash_ramp = <0x1>;
			mt,max_bled_brightness = <0x200>;
		};

		dsv {
			compatible = "mediatek,mt6370_pmu_dsv";
			interrupt-names = "dsv_vneg_ocp", "dsv_vpos_ocp", "dsv_bst_ocp", "dsv_vneg_scp", "dsv_vpos_scp";
			db_ext_en = <0x0>;
			db_periodic_fix = <0x0>;
			db_single_pin = <0x0>;
			db_freq_pm = <0x0>;
			db_periodic_mode = <0x0>;
			db_startup = <0x0>;
			db_vneg_20ms = <0x1>;
			db_vneg_disc = <0x0>;
			db_vpos_20ms = <0x1>;
			db_vpos_disc = <0x0>;
			db_delay = <0x3>;
			db_vbst = <0x1644>;
			db_vpos_slew = <0x1>;
			db_vneg_slew = <0x1>;

			mt6370_dsvp {
				regulator-name = "dsv_pos";
				regulator-min-microvolt = <0x3d0900>;
				regulator-max-microvolt = <0x5b8d80>;
			};

			mt6370_dsvn {
				regulator-name = "dsv_neg";
				regulator-min-microvolt = <0x3d0900>;
				regulator-max-microvolt = <0x5b8d80>;
			};
		};
	};

	type_c_port0 {
		tcpc-dual,supported_modes = <0x0>;
		mt-tcpc,name = "type_c_port0";
		mt-tcpc,role_def = <0x4>;
		mt-tcpc,rp_level = <0x0>;
		mt-tcpc,vconn_supply = <0x1>;
		mt6370pd,intr_gpio = <0x1c 0x18 0x0>;
		mt6370pd,intr_gpio_num = <0x18>;
		linux,phandle = <0xa9>;
		phandle = <0xa9>;

		pd-data {
			pd,vid = <0x29cf>;
			pd,pid = <0x5081>;
			pd,source-cap-ext = <0x171129cf 0x0 0x102 0x0 0x0 0x2000000>;
			pd,mfrs = "RichtekTCPC";
			pd,charging_policy = <0x21>;
			pd,source-pdo-size = <0x1>;
			pd,source-pdo-data = <0x19032>;
			pd,sink-pdo-size = <0x2>;
			pd,sink-pdo-data = <0x190c8 0xc0761e3c>;
			pd,id-vdo-size = <0x3>;
			pd,id-vdo-data = <0xd10029cf 0x0 0x10000>;
			bat,nr = <0x1>;
			pd,country_nr = <0x0>;

			bat-info0 {
				bat,vid = <0x29cf>;
				bat,pid = <0x1711>;
				bat,mfrs = "bat1";
				bat,design_cap = <0xbb8>;
			};
		};

		dpm_caps {
			local_dr_power;
			local_dr_data;
			local_usb_comm;
			local_no_suspend;
			local_vconn_supply;
			attemp_enter_dp_mode;
			attemp_discover_cable;
			attemp_discover_id;
			pr_check = <0x0>;
			pr_check_gp_source;
			dr_check = <0x0>;
		};
	};

	__symbols__ {
		chosen = "/chosen";
		cpu0 = "/cpus/cpu@000";
		cpu1 = "/cpus/cpu@001";
		cpu2 = "/cpus/cpu@002";
		cpu3 = "/cpus/cpu@003";
		STANDBY = "/cpus/idle-states/standby";
		MCDI_CPU = "/cpus/idle-states/mcdi-cpu";
		MCDI_CLUSTER = "/cpus/idle-states/mcdi-cluster";
		SODI = "/cpus/idle-states/sodi";
		SODI3 = "/cpus/idle-states/sodi3";
		DPIDLE = "/cpus/idle-states/dpidle";
		SUSPEND = "/cpus/idle-states/suspend";
		cpu_dbgapb = "/cpu_dbgapb@0d410000";
		gic = "/interrupt-controller@0c000000";
		sysirq = "/intpol-controller@10200a80";
		infracfg_ao = "/infracfg_ao@10001000";
		scpsys = "/scpsys@10001000";
		topckgen = "/topckgen@10000000";
		syscfg_pctl_1 = "/syscfg_pctl_1@10002000";
		syscfg_pctl_2 = "/syscfg_pctl_2@10002200";
		syscfg_pctl_3 = "/syscfg_pctl_3@10002400";
		syscfg_pctl_4 = "/syscfg_pctl_4@10002600";
		syscfg_pctl_5 = "/syscfg_pctl_5@10002800";
		syscfg_pctl_6 = "/syscfg_pctl_6@10002a00";
		syscfg_pctl_7 = "/syscfg_pctl_7@10002c00";
		pericfg = "/pericfg@10003000";
		smart_pa = "/smart_pa";
		tcpc_pd = "/tcpc_pd";
		md1_sim1_hot_plug_eint = "/md1_sim1_hot_plug_eint";
		md1_sim2_hot_plug_eint = "/md1_sim2_hot_plug_eint";
		gpio_usage_mapping = "/gpio";
		gpio = "/gpio@10005000";
		syscfg_pctl_0 = "/syscfg_pctl_0@10005000";
		pio = "/pinctrl@1000b000";
		msdc0_pins_default = "/pinctrl@1000b000/msdc0@default";
		msdc0_pins_hs400 = "/pinctrl@1000b000/msdc0@hs400";
		msdc0_pins_hs200 = "/pinctrl@1000b000/msdc0@hs200";
		msdc0_register_setting_default = "/pinctrl@1000b000/msdc0@register_default";
		msdc1_pins_default = "/pinctrl@1000b000/msdc1@default";
		msdc1_pins_sdr104 = "/pinctrl@1000b000/msdc1@sdr104";
		msdc1_pins_sdr50 = "/pinctrl@1000b000/msdc1@sdr50";
		msdc1_pins_ddr50 = "/pinctrl@1000b000/msdc1@ddr50";
		msdc1_register_setting_default = "/pinctrl@1000b000/msdc1@register_default";
		msdc3_pins_default = "/pinctrl@1000b000/msdc3@default";
		msdc3_register_setting_default = "/pinctrl@1000b000/msdc3@register_default";
		clk26m = "/clocks/clk26m";
		clk32k = "/clocks/clk32k";
		timer = "/timer@10008000";
		apmixed = "/apmixed@1000c000";
		main_pmic = "/mt-pmic";
		pmic_auxadc = "/mt-pmic/mt635x-auxadc";
		mt_pmic_vs1_buck_reg = "/mt-pmic/buck_regulators/buck_vs1";
		mt_pmic_vmodem_buck_reg = "/mt-pmic/buck_regulators/buck_vmodem";
		mt_pmic_vcore_buck_reg = "/mt-pmic/buck_regulators/buck_vcore";
		mt_pmic_vproc_buck_reg = "/mt-pmic/buck_regulators/buck_vproc";
		mt_pmic_vpa_buck_reg = "/mt-pmic/buck_regulators/buck_vpa";
		mt_pmic_vfe28_ldo_reg = "/mt-pmic/ldo_regulators/ldo_vfe28";
		mt_pmic_vxo22_ldo_reg = "/mt-pmic/ldo_regulators/ldo_vxo22";
		mt_pmic_vrf18_ldo_reg = "/mt-pmic/ldo_regulators/ldo_vrf18";
		mt_pmic_vrf12_ldo_reg = "/mt-pmic/ldo_regulators/ldo_vrf12";
		mt_pmic_vefuse_ldo_reg = "/mt-pmic/ldo_regulators/ldo_vefuse";
		mt_pmic_vcn33_bt_ldo_reg = "/mt-pmic/ldo_regulators/ldo_vcn33_bt";
		mt_pmic_vcn33_wifi_ldo_reg = "/mt-pmic/ldo_regulators/ldo_vcn33_wifi";
		mt_pmic_vcn28_ldo_reg = "/mt-pmic/ldo_regulators/ldo_vcn28";
		mt_pmic_vcn18_ldo_reg = "/mt-pmic/ldo_regulators/ldo_vcn18";
		mt_pmic_vcama_ldo_reg = "/mt-pmic/ldo_regulators/ldo_vcama";
		mt_pmic_vcamd_ldo_reg = "/mt-pmic/ldo_regulators/ldo_vcamd";
		mt_pmic_vcamio_ldo_reg = "/mt-pmic/ldo_regulators/ldo_vcamio";
		mt_pmic_vldo28_ldo_reg = "/mt-pmic/ldo_regulators/ldo_vldo28";
		mt_pmic_vsram_others_ldo_reg = "/mt-pmic/ldo_regulators/ldo_vsram_others";
		mt_pmic_vsram_proc_ldo_reg = "/mt-pmic/ldo_regulators/ldo_vsram_proc";
		mt_pmic_vaux18_ldo_reg = "/mt-pmic/ldo_regulators/ldo_vaux18";
		mt_pmic_vaud28_ldo_reg = "/mt-pmic/ldo_regulators/ldo_vaud28";
		mt_pmic_vio28_ldo_reg = "/mt-pmic/ldo_regulators/ldo_vio28";
		mt_pmic_vio18_ldo_reg = "/mt-pmic/ldo_regulators/ldo_vio18";
		mt_pmic_vdram_ldo_reg = "/mt-pmic/ldo_regulators/ldo_vdram";
		mt_pmic_vmc_ldo_reg = "/mt-pmic/ldo_regulators/ldo_vmc";
		mt_pmic_vmch_ldo_reg = "/mt-pmic/ldo_regulators/ldo_vmch";
		mt_pmic_vemc_ldo_reg = "/mt-pmic/ldo_regulators/ldo_vemc";
		mt_pmic_vsim1_ldo_reg = "/mt-pmic/ldo_regulators/ldo_vsim1";
		mt_pmic_vsim2_ldo_reg = "/mt-pmic/ldo_regulators/ldo_vsim2";
		mt_pmic_vibr_ldo_reg = "/mt-pmic/ldo_regulators/ldo_vibr";
		mt_pmic_vusb33_ldo_reg = "/mt-pmic/ldo_regulators/ldo_vusb33";
		keypad = "/kp@10010000";
		mrdump_ext_rst = "/mrdump_ext_rst";
		key_google = "/key_google";
		touch = "/touch";
		lcm = "/lcm_gpio";
		accdet = "/accdet";
		goodix_fp = "/fingerprint";
		bat_gm30 = "/battery";
		iommu = "/m4u@10205000";
		mdcldma = "/mdcldma@10014000";
		gce = "/gce@10238000";
		gce_mbox = "/gce_mbox@10238000";
		auxadc = "/auxadc@11001000";
		apdma = "/dma-controller@11000580";
		uart0 = "/serial@11020000";
		uart1 = "/serial@11030000";
		pwm = "/pwm@11006000";
		i2c_common = "/i2c_common";
		i2c0 = "/i2c0@11007000";
		i2c1 = "/i2c1@11008000";
		i2c2 = "/i2c2@11009000";
		i2c3 = "/i2c3@1100f000";
		i2c4 = "/i2c4@11011000";
		i2c5 = "/i2c5@11016000";
		i2c6 = "/i2c6@1100d000";
		i2c7 = "/i2c7";
		i2c8 = "/i2c8";
		i2c9 = "/i2c9";
		spi0 = "/spi0@1100a000";
		consys = "/consys@18002000";
		spi1 = "/spi1@11010000";
		spi2 = "/spi2@11012000";
		spi3 = "/spi3@11013000";
		spi4 = "/spi4@11014000";
		spi5 = "/spi5@11015000";
		msdc0 = "/msdc@11230000";
		msdc1 = "/msdc@11240000";
		msdc2 = "/msdc@11250000";
		msdc3 = "/msdc@11260000";
		msdc1_ins = "/msdc1_ins@0";
		audio = "/audio@11220000";
		audgpio = "/mt_soc_dl1_pcm@11220000";
		mipi_rx_ana_csi0a = "/mipi_rx_ana_csi0a@11c10000";
		mipi_rx_ana_csi0b = "/mipi_rx_ana_csi0b@11c11000";
		mipi_rx_ana_csi1a = "/mipi_rx_ana_csi1a@11c12000";
		mipi_rx_ana_csi1b = "/mipi_rx_ana_csi1b@11c13000";
		mipi_rx_ana_csi2a = "/mipi_rx_ana_csi2a@11c14000";
		mipi_rx_ana_csi2b = "/mipi_rx_ana_csi2b@11c15000";
		mfg_cfg = "/mfg_cfg@13ffe000";
		mmsys_config = "/mmsys_config@14000000";
		nfc = "/nfc";
		irq_nfc = "/irq_nfc";
		disp_mutex0 = "/disp_mutex0@14001000";
		smi_larb0 = "/smi_larb0@14003000";
		mdp_rdma0 = "/mdp_rdma0@14004000";
		mdp_ccorr = "/mdp_ccorr0@14005000";
		mdp_rsz0 = "/mdp_rsz0@14006000";
		mdp_rsz1 = "/mdp_rsz1@14007000";
		mdp_wdma0 = "/mdp_wdma0@14008000";
		mdp_wrot0 = "/mdp_wrot0@14009000";
		mdp_tdshp0 = "/mdp_tdshp0@1400a000";
		disp_color0 = "/disp_color0@1400f000";
		mtkfb = "/mtkfb@0";
		swtp = "/swtp";
		dsi_te = "/dsi_te";
		mm_mutex = "/mm_mutex@14016000";
		camsys = "/camsys@15000000";
		smi_larb2 = "/smi_larb2@15001000";
		kd_camera_hw1 = "/kd_camera_hw1@15040000";
		flashlight_core = "/flashlight_core";
		flashlights_mt6370 = "/flashlights_mt6370";
		flashlights_ocp8132a = "/flashlights_ocp8132a";
		venc_gcon = "/venc_gcon@17000000";
		smi_larb1 = "/smi_larb1@17010000";
		otg_iddig = "/otg_iddig";
		odm = "/odm";
		radio_md_cfg = "/radio_md_cfg";
		dynamic_options = "/dynamic_options";
		mt_charger = "/mt_charger";
		lk_charger = "/lk_charger";
		charger = "/charger";
		rt9465_slave_chr = "/rt9465_slave_chr";
		subpmic_pmu_eint = "/mt6370_pmu_eint";
		pmic_clock_buffer_ctrl = "/pmic_clock_buffer_ctrl";
		mt6370_pmu = "/mt6370_pmu_dts";
		mt6370_typec = "/type_c_port0";
	};
};
